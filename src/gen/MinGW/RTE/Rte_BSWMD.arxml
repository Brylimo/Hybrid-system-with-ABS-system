AUTOSAR XML (schema 4-0-2)
standard types defined: uint8, sint8, sint16, boolean, float32, float64
package /AUTOSAR_Rte/BswModuleDescriptions
  bsw module description Rte
    provided-entrys:
      Rte_ActivateRE
      Rte_Call_ACT_HYDRAULIC_MODULATOR_FRONTL_COMP_ACT_HM_FL_Client_set_E_op
      Rte_Call_ACT_HYDRAULIC_MODULATOR_FRONTR_COMP_ACT_HM_FR_Client_set_E_op
      Rte_Call_ACT_HYDRAULIC_MODULATOR_REARL_COMP_ACT_HM_RL_Client_set_E_op
      Rte_Call_ACT_HYDRAULIC_MODULATOR_REARR_COMP_ACT_HM_RR_Client_set_E_op
      Rte_Call_ACT_MOTOR_COMP_CS_MOTOR_Client_motor_act_op
      Rte_Call_AccelPedalSen_RPort_get_AccelPedal_Status
      Rte_Call_BrakePedalSen_RPort_get_BrakePedal_Status
      Rte_Call_Cylinder_Sen_Rport_get_cylinder_Status
      Rte_Call_Engine_Cycle_ACT_Engine_Cleintport_set_engine
      Rte_Call_Engine_Gear_ACT_phyGear_relayPport_set_phygear
      Rte_Call_GearModeSen_RPort_get_Gear_Mode
      Rte_Call_SEN_BATT_COMP_CS_BATT_Receive_batt_sen_op
      Rte_Call_SpeedSen_RPort_get_Tire_RPM
      Rte_DRead_ACT_HYDRAULIC_MODULATOR_FRONTL_COMP_ACT_HM_FL_Recv_modedata
      Rte_DRead_ACT_HYDRAULIC_MODULATOR_FRONTR_COMP_ACT_HM_FR_Recv_modedata
      Rte_DRead_ACT_HYDRAULIC_MODULATOR_REARL_COMP_ACT_HM_RL_Recv_modedata
      Rte_DRead_ACT_HYDRAULIC_MODULATOR_REARR_COMP_ACT_HM_RR_Recv_modedata
      Rte_DRead_ACT_MOTOR_COMP_SR_MOTOR_SPEED_Recv_motor_speed_data
      Rte_DRead_APP_BRAKE_CONTROLL_COMP_APP_Speed_Receive_backleft
      Rte_DRead_APP_BRAKE_CONTROLL_COMP_APP_Speed_Receive_backright
      Rte_DRead_APP_BRAKE_CONTROLL_COMP_APP_Speed_Receive_frontleft
      Rte_DRead_APP_BRAKE_CONTROLL_COMP_APP_Speed_Receive_frontright
      Rte_DRead_APP_MOTOR_COMP_SR_BATT_Recv_batt_data
      Rte_DRead_APP_MOTOR_COMP_SR_PWM_Recv_pwm_data
      Rte_DRead_AccelControlAPP_R_Accel_accel_value
      Rte_DRead_AccelControlAPP_R_AvgSpeed_avg_speed_data
      Rte_DRead_AccelControlAPP_R_Brake_brake_value
      Rte_DRead_AccelControlAPP_R_Gear_gear_value
      Rte_DRead_AvgSpeed_R_4speeds_backleft
      Rte_DRead_AvgSpeed_R_4speeds_backright
      Rte_DRead_AvgSpeed_R_4speeds_frontleft
      Rte_DRead_AvgSpeed_R_4speeds_frontright
      Rte_DRead_EngineApp_Cylinder_Rport_pressure
      Rte_DRead_EngineApp_Cylinder_Rport_temperature
      Rte_DRead_EngineApp_Power_Rport_powerValue
      Rte_DecrementWaitingCount
      Rte_GetCurrentTaskIndex
      Rte_MainFunction
      Rte_ReadQueue
      Rte_Read_Engine_Cycle_ACT_CycleData_Rport_infoArray
      Rte_SetEvent
      Rte_Start
      Rte_Stop
      Rte_Tick_Timeouts
      Rte_Trigger_APP_MOTOR_COMP_TR_BATT_LOW_set_low
      Rte_Trigger_APP_MOTOR_COMP_TR_BATT_LOW_set_normal
      Rte_Trigger_EngineApp_PhyGear_Pport_level{1..3}
      Rte_WaitWithTimeout
      Rte_WriteQueue
      Rte_Write_APP_BRAKE_CONTROLL_COMP_APP_FL_Mode_Send_modedata
      Rte_Write_APP_BRAKE_CONTROLL_COMP_APP_FR_Mode_Send_modedata
      Rte_Write_APP_BRAKE_CONTROLL_COMP_APP_RL_Mode_Send_modedata
      Rte_Write_APP_BRAKE_CONTROLL_COMP_APP_RR_Mode_Send_modedata
      Rte_Write_APP_MOTOR_COMP_SR_MOTOR_SPEED_Send_motor_speed_data
      Rte_Write_AccelControlAPP_P_EnginePower_powerValue
      Rte_Write_AccelControlAPP_P_PWM_pwm_data
      Rte_Write_AccelPedalSen_toApp_PPort_accel_value
      Rte_Write_AvgSpeed_P_avg_speed_avg_speed_data
      Rte_Write_BrakePedalSen_toApp_PPort_brake_value
      Rte_Write_Cylinder_Sen_Pport_pressure
      Rte_Write_Cylinder_Sen_Pport_temperature
      Rte_Write_EngineApp_CycleData_Pport_infoArray
      Rte_Write_GearModeSen_toApp_PPort_gear_value
      Rte_Write_SEN_BATT_COMP_SR_BATT_Send_batt_data
      Rte_Write_SpeedSen_toApp_PPort_backleft
      Rte_Write_SpeedSen_toApp_PPort_backright
      Rte_Write_SpeedSen_toApp_PPort_frontleft
      Rte_Write_SpeedSen_toApp_PPort_frontright
      Rte_memcpy
      SchM_Deinit
      SchM_Init
    outgoing-callbacks:
      Rte_StartHook_Return
      Rte_StartHook_Start
      Rte_StopHook_Return
      Rte_StopHook_Start
      Rte_Task_Activate
      Rte_Task_SetEvent
      Rte_Task_WaitEvent
      Rte_Task_WaitEventRet
    bsw module dependency AUTOSAR_Os: target-module-id=1
      required-entrys:
        ActivateTask
        CancelAlarm
        ClearEvent
        GetEvent
        GetResource
        GetTaskID
        IncrementCounter
        Os_IncrementCounter_Rte_TOutCounter
        ReleaseResource
        ResumeOSInterrupts
        SetEvent
        SetRelAlarm
        SuspendOSInterrupts
        TerminateTask
        WaitEvent
    bsw internal behavior RteInternalBehavior
      constant-memorys:
        79 x parameter data prototype:
          Rte_Inst_ACT_HYDRAULIC_MODULATOR_FRONTL_COMP: type=Rte_CDS_ACT_HYDRAULIC_MODULATOR_FRONTL_COMP
          Rte_Inst_ACT_HYDRAULIC_MODULATOR_FRONTR_COMP: type=Rte_CDS_ACT_HYDRAULIC_MODULATOR_FRONTR_COMP
          Rte_Inst_ACT_HYDRAULIC_MODULATOR_REARL_COMP: type=Rte_CDS_ACT_HYDRAULIC_MODULATOR_REARL_COMP
          Rte_Inst_ACT_HYDRAULIC_MODULATOR_REARR_COMP: type=Rte_CDS_ACT_HYDRAULIC_MODULATOR_REARR_COMP
          Rte_Inst_ACT_MOTOR_COMP: type=Rte_CDS_ACT_MOTOR_COMP
          Rte_Inst_APP_BRAKE_CONTROLL_COMP: type=Rte_CDS_APP_BRAKE_CONTROLL_COMP
          Rte_Inst_APP_MOTOR_COMP: type=Rte_CDS_APP_MOTOR_COMP
          Rte_Inst_AccelControlAPP: type=Rte_CDS_AccelControlAPP
          Rte_Inst_AccelPedalSen: type=Rte_CDS_AccelPedalSen
          Rte_Inst_AvgSpeed: type=Rte_CDS_AvgSpeed
          Rte_Inst_BrakePedalSen: type=Rte_CDS_BrakePedalSen
          Rte_Inst_Cylinder_Sen: type=Rte_CDS_Cylinder_Sen
          Rte_Inst_ECU_ABS: type=Rte_CDS_ECU_ABS
          Rte_Inst_EngineApp: type=Rte_CDS_EngineApp
          Rte_Inst_Engine_Cycle_ACT: type=Rte_CDS_Engine_Cycle_ACT
          Rte_Inst_Engine_Gear_ACT: type=Rte_CDS_Engine_Gear_ACT
          Rte_Inst_GearModeSen: type=Rte_CDS_GearModeSen
          Rte_Inst_SEN_BATT_COMP: type=Rte_CDS_SEN_BATT_COMP
          Rte_Inst_SpeedSen: type=Rte_CDS_SpeedSen
          Rte_Queue_CPT_ACT_HYDRAULIC_MODULATOR_FRONTL_COMP_ACT_HM_FL_Client_set_E_op: type=Rte_QWWPType
          Rte_Queue_CPT_ACT_HYDRAULIC_MODULATOR_FRONTL_COMP_ACT_HM_FL_Client_set_E_op_wowp: type=Rte_WOWP_NotificationType
          Rte_Queue_CPT_ACT_HYDRAULIC_MODULATOR_FRONTR_COMP_ACT_HM_FR_Client_set_E_op: type=Rte_QWWPType
          Rte_Queue_CPT_ACT_HYDRAULIC_MODULATOR_FRONTR_COMP_ACT_HM_FR_Client_set_E_op_wowp: type=Rte_WOWP_NotificationType
          Rte_Queue_CPT_ACT_HYDRAULIC_MODULATOR_REARL_COMP_ACT_HM_RL_Client_set_E_op: type=Rte_QWWPType
          Rte_Queue_CPT_ACT_HYDRAULIC_MODULATOR_REARL_COMP_ACT_HM_RL_Client_set_E_op_wowp: type=Rte_WOWP_NotificationType
          Rte_Queue_CPT_ACT_HYDRAULIC_MODULATOR_REARR_COMP_ACT_HM_RR_Client_set_E_op: type=Rte_QWWPType
          Rte_Queue_CPT_ACT_HYDRAULIC_MODULATOR_REARR_COMP_ACT_HM_RR_Client_set_E_op_wowp: type=Rte_WOWP_NotificationType
          Rte_Queue_CPT_ACT_MOTOR_COMP_CS_MOTOR_Client_motor_act_op: type=Rte_QWWPType
          Rte_Queue_CPT_ACT_MOTOR_COMP_CS_MOTOR_Client_motor_act_op_wowp: type=Rte_WOWP_NotificationType
          Rte_Queue_CPT_AccelPedalSen_RPort_get_AccelPedal_Status: type=Rte_QWWPType
          Rte_Queue_CPT_AccelPedalSen_RPort_get_AccelPedal_Status_wowp: type=Rte_WOWP_NotificationType
          Rte_Queue_CPT_BrakePedalSen_RPort_get_BrakePedal_Status: type=Rte_QWWPType
          Rte_Queue_CPT_BrakePedalSen_RPort_get_BrakePedal_Status_wowp: type=Rte_WOWP_NotificationType
          Rte_Queue_CPT_Cylinder_Sen_Rport_get_cylinder_Status: type=Rte_QWWPType
          Rte_Queue_CPT_Cylinder_Sen_Rport_get_cylinder_Status_wowp: type=Rte_WOWP_NotificationType
          Rte_Queue_CPT_ECU_ABS_ActSEngine_set_engine: type=Rte_QTaskType
          Rte_Queue_CPT_ECU_ABS_ActSGear_set_phygear: type=Rte_QTaskType
          Rte_Queue_CPT_ECU_ABS_CS_BATT_Server_batt_sen_op: type=Rte_QTaskType
          Rte_Queue_CPT_ECU_ABS_CS_MOTOR_Server_motor_act_op: type=Rte_QTaskType
          Rte_Queue_CPT_ECU_ABS_PAccelPedal_get_AccelPedal_Status: type=Rte_QTaskType
          Rte_Queue_CPT_ECU_ABS_PBrakePedal_get_BrakePedal_Status: type=Rte_QTaskType
          Rte_Queue_CPT_ECU_ABS_PCylinder_get_cylinder_Status: type=Rte_QTaskType
          Rte_Queue_CPT_ECU_ABS_PGearMode_get_Gear_Mode: type=Rte_QTaskType
          Rte_Queue_CPT_ECU_ABS_PHMFrontL_set_E_op: type=Rte_QTaskType
          Rte_Queue_CPT_ECU_ABS_PHMFrontR_set_E_op: type=Rte_QTaskType
          Rte_Queue_CPT_ECU_ABS_PHMRearL_set_E_op: type=Rte_QTaskType
          Rte_Queue_CPT_ECU_ABS_PHMRearR_set_E_op: type=Rte_QTaskType
          Rte_Queue_CPT_ECU_ABS_PTireRPM_get_Tire_RPM: type=Rte_QTaskType
          Rte_Queue_CPT_Engine_Cycle_ACT_Engine_Cleintport_set_engine: type=Rte_QWWPType
          Rte_Queue_CPT_Engine_Cycle_ACT_Engine_Cleintport_set_engine_wowp: type=Rte_WOWP_NotificationType
          Rte_Queue_CPT_Engine_Gear_ACT_phyGear_relayPport_set_phygear: type=Rte_QWWPType
          Rte_Queue_CPT_Engine_Gear_ACT_phyGear_relayPport_set_phygear_wowp: type=Rte_WOWP_NotificationType
          Rte_Queue_CPT_GearModeSen_RPort_get_Gear_Mode: type=Rte_QWWPType
          Rte_Queue_CPT_GearModeSen_RPort_get_Gear_Mode_wowp: type=Rte_WOWP_NotificationType
          Rte_Queue_CPT_SEN_BATT_COMP_CS_BATT_Receive_batt_sen_op: type=Rte_QWWPType
          Rte_Queue_CPT_SEN_BATT_COMP_CS_BATT_Receive_batt_sen_op_wowp: type=Rte_WOWP_NotificationType
          Rte_Queue_CPT_SpeedSen_RPort_get_Tire_RPM: type=Rte_QWWPType
          Rte_Queue_CPT_SpeedSen_RPort_get_Tire_RPM_wowp: type=Rte_WOWP_NotificationType
          Rte_Self_CPT_ACT_HYDRAULIC_MODULATOR_FRONTL_COMP: type=Rte_SelfType_ACT_HYDRAULIC_MODULATOR_FRONTL_COMP
          Rte_Self_CPT_ACT_HYDRAULIC_MODULATOR_FRONTR_COMP: type=Rte_SelfType_ACT_HYDRAULIC_MODULATOR_FRONTR_COMP
          Rte_Self_CPT_ACT_HYDRAULIC_MODULATOR_REARL_COMP: type=Rte_SelfType_ACT_HYDRAULIC_MODULATOR_REARL_COMP
          Rte_Self_CPT_ACT_HYDRAULIC_MODULATOR_REARR_COMP: type=Rte_SelfType_ACT_HYDRAULIC_MODULATOR_REARR_COMP
          Rte_Self_CPT_ACT_MOTOR_COMP: type=Rte_SelfType_ACT_MOTOR_COMP
          Rte_Self_CPT_APP_BRAKE_CONTROLL_COMP: type=Rte_SelfType_APP_BRAKE_CONTROLL_COMP
          Rte_Self_CPT_APP_MOTOR_COMP: type=Rte_SelfType_APP_MOTOR_COMP
          Rte_Self_CPT_AccelControlAPP: type=Rte_SelfType_AccelControlAPP
          Rte_Self_CPT_AccelPedalSen: type=Rte_SelfType_AccelPedalSen
          Rte_Self_CPT_AvgSpeed: type=Rte_SelfType_AvgSpeed
          Rte_Self_CPT_BrakePedalSen: type=Rte_SelfType_BrakePedalSen
          Rte_Self_CPT_Cylinder_Sen: type=Rte_SelfType_Cylinder_Sen
          Rte_Self_CPT_ECU_ABS: type=Rte_SelfType_ECU_ABS
          Rte_Self_CPT_EngineApp: type=Rte_SelfType_EngineApp
          Rte_Self_CPT_Engine_Cycle_ACT: type=Rte_SelfType_Engine_Cycle_ACT
          Rte_Self_CPT_Engine_Gear_ACT: type=Rte_SelfType_Engine_Gear_ACT
          Rte_Self_CPT_GearModeSen: type=Rte_SelfType_GearModeSen
          Rte_Self_CPT_SEN_BATT_COMP: type=Rte_SelfType_SEN_BATT_COMP
          Rte_Self_CPT_SpeedSen: type=Rte_SelfType_SpeedSen
          Rte_Tasks: type=Rte_TaskInfo
          Rte_TimeoutAlarms: type=Rte_AlarmRefType
      static-memorys:
        104 x data:
          Rte_ActCount_CPT_APP_BRAKE_CONTROLL_COMP_DataReceivedEvent_{0..3}: type=Rte_REActCounterType
          Rte_ActCount_CPT_AccelControlAPP_ExternalTriggerOccurredEvent_0: type=Rte_REActCounterType
          Rte_ActCount_CPT_AccelControlAPP_ExternalTriggerOccurredEvent_1: type=Rte_REActCounterType
          Rte_Event_CPT_ACT_HYDRAULIC_MODULATOR_FRONTL_COMP_ACT_HM_FL_Client_set_E_op_wd: type=Rte_WaitableDatum
          Rte_Event_CPT_ACT_HYDRAULIC_MODULATOR_FRONTR_COMP_ACT_HM_FR_Client_set_E_op_wd: type=Rte_WaitableDatum
          Rte_Event_CPT_ACT_HYDRAULIC_MODULATOR_REARL_COMP_ACT_HM_RL_Client_set_E_op_wd: type=Rte_WaitableDatum
          Rte_Event_CPT_ACT_HYDRAULIC_MODULATOR_REARR_COMP_ACT_HM_RR_Client_set_E_op_wd: type=Rte_WaitableDatum
          Rte_Event_CPT_ACT_MOTOR_COMP_CS_MOTOR_Client_motor_act_op_wd: type=Rte_WaitableDatum
          Rte_Event_CPT_AccelPedalSen_RPort_get_AccelPedal_Status_wd: type=Rte_WaitableDatum
          Rte_Event_CPT_BrakePedalSen_RPort_get_BrakePedal_Status_wd: type=Rte_WaitableDatum
          Rte_Event_CPT_Cylinder_Sen_Rport_get_cylinder_Status_wd: type=Rte_WaitableDatum
          Rte_Event_CPT_Engine_Cycle_ACT_Engine_Cleintport_set_engine_wd: type=Rte_WaitableDatum
          Rte_Event_CPT_Engine_Gear_ACT_phyGear_relayPport_set_phygear_wd: type=Rte_WaitableDatum
          Rte_Event_CPT_GearModeSen_RPort_get_Gear_Mode_wd: type=Rte_WaitableDatum
          Rte_Event_CPT_SEN_BATT_COMP_CS_BATT_Receive_batt_sen_op_wd: type=Rte_WaitableDatum
          Rte_Event_CPT_SpeedSen_RPort_get_Tire_RPM_wd: type=Rte_WaitableDatum
          Rte_Queue_CPT_ACT_HYDRAULIC_MODULATOR_FRONTL_COMP_ACT_HM_FL_Client_set_E_op_data: type=Rte_CPT_ECU_ABS_PHMFrontL_set_E_op_RtnQEType
          Rte_Queue_CPT_ACT_HYDRAULIC_MODULATOR_FRONTL_COMP_ACT_HM_FL_Client_set_E_op_dynamic: type=Rte_QDynType
          Rte_Queue_CPT_ACT_HYDRAULIC_MODULATOR_FRONTR_COMP_ACT_HM_FR_Client_set_E_op_data: type=Rte_CPT_ECU_ABS_PHMFrontR_set_E_op_RtnQEType
          Rte_Queue_CPT_ACT_HYDRAULIC_MODULATOR_FRONTR_COMP_ACT_HM_FR_Client_set_E_op_dynamic: type=Rte_QDynType
          Rte_Queue_CPT_ACT_HYDRAULIC_MODULATOR_REARL_COMP_ACT_HM_RL_Client_set_E_op_data: type=Rte_CPT_ECU_ABS_PHMRearL_set_E_op_RtnQEType
          Rte_Queue_CPT_ACT_HYDRAULIC_MODULATOR_REARL_COMP_ACT_HM_RL_Client_set_E_op_dynamic: type=Rte_QDynType
          Rte_Queue_CPT_ACT_HYDRAULIC_MODULATOR_REARR_COMP_ACT_HM_RR_Client_set_E_op_data: type=Rte_CPT_ECU_ABS_PHMRearR_set_E_op_RtnQEType
          Rte_Queue_CPT_ACT_HYDRAULIC_MODULATOR_REARR_COMP_ACT_HM_RR_Client_set_E_op_dynamic: type=Rte_QDynType
          Rte_Queue_CPT_ACT_MOTOR_COMP_CS_MOTOR_Client_motor_act_op_data: type=Rte_CPT_ECU_ABS_CS_MOTOR_Server_motor_act_op_RtnQEType
          Rte_Queue_CPT_ACT_MOTOR_COMP_CS_MOTOR_Client_motor_act_op_dynamic: type=Rte_QDynType
          Rte_Queue_CPT_AccelPedalSen_RPort_get_AccelPedal_Status_data: type=Rte_CPT_ECU_ABS_PAccelPedal_get_AccelPedal_Status_RtnQEType
          Rte_Queue_CPT_AccelPedalSen_RPort_get_AccelPedal_Status_dynamic: type=Rte_QDynType
          Rte_Queue_CPT_BrakePedalSen_RPort_get_BrakePedal_Status_data: type=Rte_CPT_ECU_ABS_PBrakePedal_get_BrakePedal_Status_RtnQEType
          Rte_Queue_CPT_BrakePedalSen_RPort_get_BrakePedal_Status_dynamic: type=Rte_QDynType
          Rte_Queue_CPT_Cylinder_Sen_Rport_get_cylinder_Status_data: type=Rte_CPT_ECU_ABS_PCylinder_get_cylinder_Status_RtnQEType
          Rte_Queue_CPT_Cylinder_Sen_Rport_get_cylinder_Status_dynamic: type=Rte_QDynType
          Rte_Queue_CPT_ECU_ABS_ActSEngine_set_engine_data: type=Rte_CPT_ECU_ABS_ActSEngine_set_engine_QEType
          Rte_Queue_CPT_ECU_ABS_ActSEngine_set_engine_dyn: type=Rte_QDynType
          Rte_Queue_CPT_ECU_ABS_ActSGear_set_phygear_data: type=Rte_CPT_ECU_ABS_ActSGear_set_phygear_QEType
          Rte_Queue_CPT_ECU_ABS_ActSGear_set_phygear_dyn: type=Rte_QDynType
          Rte_Queue_CPT_ECU_ABS_CS_BATT_Server_batt_sen_op_data: type=Rte_CPT_ECU_ABS_CS_BATT_Server_batt_sen_op_QEType
          Rte_Queue_CPT_ECU_ABS_CS_BATT_Server_batt_sen_op_dyn: type=Rte_QDynType
          Rte_Queue_CPT_ECU_ABS_CS_MOTOR_Server_motor_act_op_data: type=Rte_CPT_ECU_ABS_CS_MOTOR_Server_motor_act_op_QEType
          Rte_Queue_CPT_ECU_ABS_CS_MOTOR_Server_motor_act_op_dyn: type=Rte_QDynType
          Rte_Queue_CPT_ECU_ABS_PAccelPedal_get_AccelPedal_Status_data: type=Rte_CPT_ECU_ABS_PAccelPedal_get_AccelPedal_Status_QEType
          Rte_Queue_CPT_ECU_ABS_PAccelPedal_get_AccelPedal_Status_dyn: type=Rte_QDynType
          Rte_Queue_CPT_ECU_ABS_PBrakePedal_get_BrakePedal_Status_data: type=Rte_CPT_ECU_ABS_PBrakePedal_get_BrakePedal_Status_QEType
          Rte_Queue_CPT_ECU_ABS_PBrakePedal_get_BrakePedal_Status_dyn: type=Rte_QDynType
          Rte_Queue_CPT_ECU_ABS_PCylinder_get_cylinder_Status_data: type=Rte_CPT_ECU_ABS_PCylinder_get_cylinder_Status_QEType
          Rte_Queue_CPT_ECU_ABS_PCylinder_get_cylinder_Status_dyn: type=Rte_QDynType
          Rte_Queue_CPT_ECU_ABS_PGearMode_get_Gear_Mode_data: type=Rte_CPT_ECU_ABS_PGearMode_get_Gear_Mode_QEType
          Rte_Queue_CPT_ECU_ABS_PGearMode_get_Gear_Mode_dyn: type=Rte_QDynType
          Rte_Queue_CPT_ECU_ABS_PHMFrontL_set_E_op_data: type=Rte_CPT_ECU_ABS_PHMFrontL_set_E_op_QEType
          Rte_Queue_CPT_ECU_ABS_PHMFrontL_set_E_op_dyn: type=Rte_QDynType
          Rte_Queue_CPT_ECU_ABS_PHMFrontR_set_E_op_data: type=Rte_CPT_ECU_ABS_PHMFrontR_set_E_op_QEType
          Rte_Queue_CPT_ECU_ABS_PHMFrontR_set_E_op_dyn: type=Rte_QDynType
          Rte_Queue_CPT_ECU_ABS_PHMRearL_set_E_op_data: type=Rte_CPT_ECU_ABS_PHMRearL_set_E_op_QEType
          Rte_Queue_CPT_ECU_ABS_PHMRearL_set_E_op_dyn: type=Rte_QDynType
          Rte_Queue_CPT_ECU_ABS_PHMRearR_set_E_op_data: type=Rte_CPT_ECU_ABS_PHMRearR_set_E_op_QEType
          Rte_Queue_CPT_ECU_ABS_PHMRearR_set_E_op_dyn: type=Rte_QDynType
          Rte_Queue_CPT_ECU_ABS_PTireRPM_get_Tire_RPM_data: type=Rte_CPT_ECU_ABS_PTireRPM_get_Tire_RPM_QEType
          Rte_Queue_CPT_ECU_ABS_PTireRPM_get_Tire_RPM_dyn: type=Rte_QDynType
          Rte_Queue_CPT_Engine_Cycle_ACT_Engine_Cleintport_set_engine_data: type=Rte_CPT_ECU_ABS_ActSEngine_set_engine_RtnQEType
          Rte_Queue_CPT_Engine_Cycle_ACT_Engine_Cleintport_set_engine_dynamic: type=Rte_QDynType
          Rte_Queue_CPT_Engine_Gear_ACT_phyGear_relayPport_set_phygear_data: type=Rte_CPT_ECU_ABS_ActSGear_set_phygear_RtnQEType
          Rte_Queue_CPT_Engine_Gear_ACT_phyGear_relayPport_set_phygear_dynamic: type=Rte_QDynType
          Rte_Queue_CPT_GearModeSen_RPort_get_Gear_Mode_data: type=Rte_CPT_ECU_ABS_PGearMode_get_Gear_Mode_RtnQEType
          Rte_Queue_CPT_GearModeSen_RPort_get_Gear_Mode_dynamic: type=Rte_QDynType
          Rte_Queue_CPT_SEN_BATT_COMP_CS_BATT_Receive_batt_sen_op_data: type=Rte_CPT_ECU_ABS_CS_BATT_Server_batt_sen_op_RtnQEType
          Rte_Queue_CPT_SEN_BATT_COMP_CS_BATT_Receive_batt_sen_op_dynamic: type=Rte_QDynType
          Rte_Queue_CPT_SpeedSen_RPort_get_Tire_RPM_data: type=Rte_CPT_ECU_ABS_PTireRPM_get_Tire_RPM_RtnQEType
          Rte_Queue_CPT_SpeedSen_RPort_get_Tire_RPM_dynamic: type=Rte_QDynType
          Rte_Rx_{000000..000003}_modedata: type=sint8
          Rte_Rx_000004_motor_speed_data: type=sint16
          Rte_Rx_000005_frontleft: type=float32
          Rte_Rx_000006_frontright: type=float32
          Rte_Rx_000007_backleft: type=float32
          Rte_Rx_000008_backright: type=float32
          Rte_Rx_000009_batt_data: type=uint8
          Rte_Rx_000010_pwm_data: type=sint8
          Rte_Rx_000011_accel_value: type=sint8
          Rte_Rx_000012_avg_speed_data: type=float64
          Rte_Rx_000013_brake_value: type=sint8
          Rte_Rx_000014_gear_value: type=sint8
          Rte_Rx_000015_pressure: type=float32
          Rte_Rx_000016_temperature: type=float32
          Rte_Rx_000017_powerValue: type=sint16
          Rte_Rx_000018_infoArray: type=arr_sint8
          Rte_Var_OsTask_04WaitingEv: type=Rte_EventType
          Rte_Var_OsTask_{10..12}WaitingEv: type=Rte_EventType
          Rte_Var_OsTask_14WaitingEv: type=Rte_EventType
          Rte_Var_OsTask_15WaitingEv: type=Rte_EventType
          Rte_Var_OsTask_19WaitingEv: type=Rte_EventType
          Rte_Var_OsTask_1WaitingEv: type=Rte_EventType
          Rte_Var_OsTask_20WaitingEv: type=Rte_EventType
          Rte_Var_OsTask_21WaitingEv: type=Rte_EventType
          Rte_Var_OsTask_23WaitingEv: type=Rte_EventType
          Rte_Var_OsTask_3WaitingEv: type=Rte_EventType
          Rte_Var_OsTask_6WaitingEv: type=Rte_EventType
          Rte_Var_OsTask_7WaitingEv: type=Rte_EventType
      74 x bsw called entity, all with sw-addr-method=CODE:
        Rte_ActivateRE: implemented-entry=Rte_ActivateRE
        Rte_Call_ACT_HYDRAULIC_MODULATOR_FRONTL_COMP_ACT_HM_FL_Client_set_E_op: implemented-entry=Rte_Call_ACT_HYDRAULIC_MODULATOR_FRONTL_COMP_ACT_HM_FL_Client_set_E_op
        Rte_Call_ACT_HYDRAULIC_MODULATOR_FRONTR_COMP_ACT_HM_FR_Client_set_E_op: implemented-entry=Rte_Call_ACT_HYDRAULIC_MODULATOR_FRONTR_COMP_ACT_HM_FR_Client_set_E_op
        Rte_Call_ACT_HYDRAULIC_MODULATOR_REARL_COMP_ACT_HM_RL_Client_set_E_op: implemented-entry=Rte_Call_ACT_HYDRAULIC_MODULATOR_REARL_COMP_ACT_HM_RL_Client_set_E_op
        Rte_Call_ACT_HYDRAULIC_MODULATOR_REARR_COMP_ACT_HM_RR_Client_set_E_op: implemented-entry=Rte_Call_ACT_HYDRAULIC_MODULATOR_REARR_COMP_ACT_HM_RR_Client_set_E_op
        Rte_Call_ACT_MOTOR_COMP_CS_MOTOR_Client_motor_act_op: implemented-entry=Rte_Call_ACT_MOTOR_COMP_CS_MOTOR_Client_motor_act_op
        Rte_Call_AccelPedalSen_RPort_get_AccelPedal_Status: implemented-entry=Rte_Call_AccelPedalSen_RPort_get_AccelPedal_Status
        Rte_Call_BrakePedalSen_RPort_get_BrakePedal_Status: implemented-entry=Rte_Call_BrakePedalSen_RPort_get_BrakePedal_Status
        Rte_Call_Cylinder_Sen_Rport_get_cylinder_Status: implemented-entry=Rte_Call_Cylinder_Sen_Rport_get_cylinder_Status
        Rte_Call_Engine_Cycle_ACT_Engine_Cleintport_set_engine: implemented-entry=Rte_Call_Engine_Cycle_ACT_Engine_Cleintport_set_engine
        Rte_Call_Engine_Gear_ACT_phyGear_relayPport_set_phygear: implemented-entry=Rte_Call_Engine_Gear_ACT_phyGear_relayPport_set_phygear
        Rte_Call_GearModeSen_RPort_get_Gear_Mode: implemented-entry=Rte_Call_GearModeSen_RPort_get_Gear_Mode
        Rte_Call_SEN_BATT_COMP_CS_BATT_Receive_batt_sen_op: implemented-entry=Rte_Call_SEN_BATT_COMP_CS_BATT_Receive_batt_sen_op
        Rte_Call_SpeedSen_RPort_get_Tire_RPM: implemented-entry=Rte_Call_SpeedSen_RPort_get_Tire_RPM
        Rte_DRead_ACT_HYDRAULIC_MODULATOR_FRONTL_COMP_ACT_HM_FL_Recv_modedata: implemented-entry=Rte_DRead_ACT_HYDRAULIC_MODULATOR_FRONTL_COMP_ACT_HM_FL_Recv_modedata
        Rte_DRead_ACT_HYDRAULIC_MODULATOR_FRONTR_COMP_ACT_HM_FR_Recv_modedata: implemented-entry=Rte_DRead_ACT_HYDRAULIC_MODULATOR_FRONTR_COMP_ACT_HM_FR_Recv_modedata
        Rte_DRead_ACT_HYDRAULIC_MODULATOR_REARL_COMP_ACT_HM_RL_Recv_modedata: implemented-entry=Rte_DRead_ACT_HYDRAULIC_MODULATOR_REARL_COMP_ACT_HM_RL_Recv_modedata
        Rte_DRead_ACT_HYDRAULIC_MODULATOR_REARR_COMP_ACT_HM_RR_Recv_modedata: implemented-entry=Rte_DRead_ACT_HYDRAULIC_MODULATOR_REARR_COMP_ACT_HM_RR_Recv_modedata
        Rte_DRead_ACT_MOTOR_COMP_SR_MOTOR_SPEED_Recv_motor_speed_data: implemented-entry=Rte_DRead_ACT_MOTOR_COMP_SR_MOTOR_SPEED_Recv_motor_speed_data
        Rte_DRead_APP_BRAKE_CONTROLL_COMP_APP_Speed_Receive_backleft: implemented-entry=Rte_DRead_APP_BRAKE_CONTROLL_COMP_APP_Speed_Receive_backleft
        Rte_DRead_APP_BRAKE_CONTROLL_COMP_APP_Speed_Receive_backright: implemented-entry=Rte_DRead_APP_BRAKE_CONTROLL_COMP_APP_Speed_Receive_backright
        Rte_DRead_APP_BRAKE_CONTROLL_COMP_APP_Speed_Receive_frontleft: implemented-entry=Rte_DRead_APP_BRAKE_CONTROLL_COMP_APP_Speed_Receive_frontleft
        Rte_DRead_APP_BRAKE_CONTROLL_COMP_APP_Speed_Receive_frontright: implemented-entry=Rte_DRead_APP_BRAKE_CONTROLL_COMP_APP_Speed_Receive_frontright
        Rte_DRead_APP_MOTOR_COMP_SR_BATT_Recv_batt_data: implemented-entry=Rte_DRead_APP_MOTOR_COMP_SR_BATT_Recv_batt_data
        Rte_DRead_APP_MOTOR_COMP_SR_PWM_Recv_pwm_data: implemented-entry=Rte_DRead_APP_MOTOR_COMP_SR_PWM_Recv_pwm_data
        Rte_DRead_AccelControlAPP_R_Accel_accel_value: implemented-entry=Rte_DRead_AccelControlAPP_R_Accel_accel_value
        Rte_DRead_AccelControlAPP_R_AvgSpeed_avg_speed_data: implemented-entry=Rte_DRead_AccelControlAPP_R_AvgSpeed_avg_speed_data
        Rte_DRead_AccelControlAPP_R_Brake_brake_value: implemented-entry=Rte_DRead_AccelControlAPP_R_Brake_brake_value
        Rte_DRead_AccelControlAPP_R_Gear_gear_value: implemented-entry=Rte_DRead_AccelControlAPP_R_Gear_gear_value
        Rte_DRead_AvgSpeed_R_4speeds_backleft: implemented-entry=Rte_DRead_AvgSpeed_R_4speeds_backleft
        Rte_DRead_AvgSpeed_R_4speeds_backright: implemented-entry=Rte_DRead_AvgSpeed_R_4speeds_backright
        Rte_DRead_AvgSpeed_R_4speeds_frontleft: implemented-entry=Rte_DRead_AvgSpeed_R_4speeds_frontleft
        Rte_DRead_AvgSpeed_R_4speeds_frontright: implemented-entry=Rte_DRead_AvgSpeed_R_4speeds_frontright
        Rte_DRead_EngineApp_Cylinder_Rport_pressure: implemented-entry=Rte_DRead_EngineApp_Cylinder_Rport_pressure
        Rte_DRead_EngineApp_Cylinder_Rport_temperature: implemented-entry=Rte_DRead_EngineApp_Cylinder_Rport_temperature
        Rte_DRead_EngineApp_Power_Rport_powerValue: implemented-entry=Rte_DRead_EngineApp_Power_Rport_powerValue
        Rte_DecrementWaitingCount: implemented-entry=Rte_DecrementWaitingCount
        Rte_GetCurrentTaskIndex: implemented-entry=Rte_GetCurrentTaskIndex
        Rte_MainFunction: implemented-entry=Rte_MainFunction
        Rte_ReadQueue: implemented-entry=Rte_ReadQueue
        Rte_Read_Engine_Cycle_ACT_CycleData_Rport_infoArray: implemented-entry=Rte_Read_Engine_Cycle_ACT_CycleData_Rport_infoArray
        Rte_SetEvent: implemented-entry=Rte_SetEvent
        Rte_Start: implemented-entry=Rte_Start
        Rte_Stop: implemented-entry=Rte_Stop
        Rte_Tick_Timeouts: implemented-entry=Rte_Tick_Timeouts
        Rte_Trigger_APP_MOTOR_COMP_TR_BATT_LOW_set_low: implemented-entry=Rte_Trigger_APP_MOTOR_COMP_TR_BATT_LOW_set_low
        Rte_Trigger_APP_MOTOR_COMP_TR_BATT_LOW_set_normal: implemented-entry=Rte_Trigger_APP_MOTOR_COMP_TR_BATT_LOW_set_normal
        Rte_Trigger_EngineApp_PhyGear_Pport_level{1..3}: implemented-entry=Rte_Trigger_EngineApp_PhyGear_Pport_level{1..3}
        Rte_WaitWithTimeout: implemented-entry=Rte_WaitWithTimeout
        Rte_WriteQueue: implemented-entry=Rte_WriteQueue
        Rte_Write_APP_BRAKE_CONTROLL_COMP_APP_FL_Mode_Send_modedata: implemented-entry=Rte_Write_APP_BRAKE_CONTROLL_COMP_APP_FL_Mode_Send_modedata
        Rte_Write_APP_BRAKE_CONTROLL_COMP_APP_FR_Mode_Send_modedata: implemented-entry=Rte_Write_APP_BRAKE_CONTROLL_COMP_APP_FR_Mode_Send_modedata
        Rte_Write_APP_BRAKE_CONTROLL_COMP_APP_RL_Mode_Send_modedata: implemented-entry=Rte_Write_APP_BRAKE_CONTROLL_COMP_APP_RL_Mode_Send_modedata
        Rte_Write_APP_BRAKE_CONTROLL_COMP_APP_RR_Mode_Send_modedata: implemented-entry=Rte_Write_APP_BRAKE_CONTROLL_COMP_APP_RR_Mode_Send_modedata
        Rte_Write_APP_MOTOR_COMP_SR_MOTOR_SPEED_Send_motor_speed_data: implemented-entry=Rte_Write_APP_MOTOR_COMP_SR_MOTOR_SPEED_Send_motor_speed_data
        Rte_Write_AccelControlAPP_P_EnginePower_powerValue: implemented-entry=Rte_Write_AccelControlAPP_P_EnginePower_powerValue
        Rte_Write_AccelControlAPP_P_PWM_pwm_data: implemented-entry=Rte_Write_AccelControlAPP_P_PWM_pwm_data
        Rte_Write_AccelPedalSen_toApp_PPort_accel_value: implemented-entry=Rte_Write_AccelPedalSen_toApp_PPort_accel_value
        Rte_Write_AvgSpeed_P_avg_speed_avg_speed_data: implemented-entry=Rte_Write_AvgSpeed_P_avg_speed_avg_speed_data
        Rte_Write_BrakePedalSen_toApp_PPort_brake_value: implemented-entry=Rte_Write_BrakePedalSen_toApp_PPort_brake_value
        Rte_Write_Cylinder_Sen_Pport_pressure: implemented-entry=Rte_Write_Cylinder_Sen_Pport_pressure
        Rte_Write_Cylinder_Sen_Pport_temperature: implemented-entry=Rte_Write_Cylinder_Sen_Pport_temperature
        Rte_Write_EngineApp_CycleData_Pport_infoArray: implemented-entry=Rte_Write_EngineApp_CycleData_Pport_infoArray
        Rte_Write_GearModeSen_toApp_PPort_gear_value: implemented-entry=Rte_Write_GearModeSen_toApp_PPort_gear_value
        Rte_Write_SEN_BATT_COMP_SR_BATT_Send_batt_data: implemented-entry=Rte_Write_SEN_BATT_COMP_SR_BATT_Send_batt_data
        Rte_Write_SpeedSen_toApp_PPort_backleft: implemented-entry=Rte_Write_SpeedSen_toApp_PPort_backleft
        Rte_Write_SpeedSen_toApp_PPort_backright: implemented-entry=Rte_Write_SpeedSen_toApp_PPort_backright
        Rte_Write_SpeedSen_toApp_PPort_frontleft: implemented-entry=Rte_Write_SpeedSen_toApp_PPort_frontleft
        Rte_Write_SpeedSen_toApp_PPort_frontright: implemented-entry=Rte_Write_SpeedSen_toApp_PPort_frontright
        Rte_memcpy: implemented-entry=Rte_memcpy
        SchM_Deinit: implemented-entry=SchM_Deinit
        SchM_Init: implemented-entry=SchM_Init
package /AUTOSAR_Rte/BswModuleEntrys
  82 x bsw module entry:
    Rte_ActivateRE: call-type=REGULAR
    Rte_Call_ACT_HYDRAULIC_MODULATOR_FRONTL_COMP_ACT_HM_FL_Client_set_E_op: call-type=REGULAR
    Rte_Call_ACT_HYDRAULIC_MODULATOR_FRONTR_COMP_ACT_HM_FR_Client_set_E_op: call-type=REGULAR
    Rte_Call_ACT_HYDRAULIC_MODULATOR_REARL_COMP_ACT_HM_RL_Client_set_E_op: call-type=REGULAR
    Rte_Call_ACT_HYDRAULIC_MODULATOR_REARR_COMP_ACT_HM_RR_Client_set_E_op: call-type=REGULAR
    Rte_Call_ACT_MOTOR_COMP_CS_MOTOR_Client_motor_act_op: call-type=REGULAR
    Rte_Call_AccelPedalSen_RPort_get_AccelPedal_Status: call-type=REGULAR
    Rte_Call_BrakePedalSen_RPort_get_BrakePedal_Status: call-type=REGULAR
    Rte_Call_Cylinder_Sen_Rport_get_cylinder_Status: call-type=REGULAR
    Rte_Call_Engine_Cycle_ACT_Engine_Cleintport_set_engine: call-type=REGULAR
    Rte_Call_Engine_Gear_ACT_phyGear_relayPport_set_phygear: call-type=REGULAR
    Rte_Call_GearModeSen_RPort_get_Gear_Mode: call-type=REGULAR
    Rte_Call_SEN_BATT_COMP_CS_BATT_Receive_batt_sen_op: call-type=REGULAR
    Rte_Call_SpeedSen_RPort_get_Tire_RPM: call-type=REGULAR
    Rte_DRead_ACT_HYDRAULIC_MODULATOR_FRONTL_COMP_ACT_HM_FL_Recv_modedata: call-type=REGULAR
    Rte_DRead_ACT_HYDRAULIC_MODULATOR_FRONTR_COMP_ACT_HM_FR_Recv_modedata: call-type=REGULAR
    Rte_DRead_ACT_HYDRAULIC_MODULATOR_REARL_COMP_ACT_HM_RL_Recv_modedata: call-type=REGULAR
    Rte_DRead_ACT_HYDRAULIC_MODULATOR_REARR_COMP_ACT_HM_RR_Recv_modedata: call-type=REGULAR
    Rte_DRead_ACT_MOTOR_COMP_SR_MOTOR_SPEED_Recv_motor_speed_data: call-type=REGULAR
    Rte_DRead_APP_BRAKE_CONTROLL_COMP_APP_Speed_Receive_backleft: call-type=REGULAR
    Rte_DRead_APP_BRAKE_CONTROLL_COMP_APP_Speed_Receive_backright: call-type=REGULAR
    Rte_DRead_APP_BRAKE_CONTROLL_COMP_APP_Speed_Receive_frontleft: call-type=REGULAR
    Rte_DRead_APP_BRAKE_CONTROLL_COMP_APP_Speed_Receive_frontright: call-type=REGULAR
    Rte_DRead_APP_MOTOR_COMP_SR_BATT_Recv_batt_data: call-type=REGULAR
    Rte_DRead_APP_MOTOR_COMP_SR_PWM_Recv_pwm_data: call-type=REGULAR
    Rte_DRead_AccelControlAPP_R_Accel_accel_value: call-type=REGULAR
    Rte_DRead_AccelControlAPP_R_AvgSpeed_avg_speed_data: call-type=REGULAR
    Rte_DRead_AccelControlAPP_R_Brake_brake_value: call-type=REGULAR
    Rte_DRead_AccelControlAPP_R_Gear_gear_value: call-type=REGULAR
    Rte_DRead_AvgSpeed_R_4speeds_backleft: call-type=REGULAR
    Rte_DRead_AvgSpeed_R_4speeds_backright: call-type=REGULAR
    Rte_DRead_AvgSpeed_R_4speeds_frontleft: call-type=REGULAR
    Rte_DRead_AvgSpeed_R_4speeds_frontright: call-type=REGULAR
    Rte_DRead_EngineApp_Cylinder_Rport_pressure: call-type=REGULAR
    Rte_DRead_EngineApp_Cylinder_Rport_temperature: call-type=REGULAR
    Rte_DRead_EngineApp_Power_Rport_powerValue: call-type=REGULAR
    Rte_DecrementWaitingCount: call-type=REGULAR
    Rte_GetCurrentTaskIndex: call-type=REGULAR
    Rte_MainFunction: call-type=REGULAR
    Rte_ReadQueue: call-type=REGULAR
    Rte_Read_Engine_Cycle_ACT_CycleData_Rport_infoArray: call-type=REGULAR
    Rte_SetEvent: call-type=REGULAR
    Rte_Start: call-type=REGULAR
    Rte_StartHook_Return: call-type=CALLBACK
    Rte_StartHook_Start: call-type=CALLBACK
    Rte_Stop: call-type=REGULAR
    Rte_StopHook_Return: call-type=CALLBACK
    Rte_StopHook_Start: call-type=CALLBACK
    Rte_Task_Activate: call-type=CALLBACK
    Rte_Task_SetEvent: call-type=CALLBACK
    Rte_Task_WaitEvent: call-type=CALLBACK
    Rte_Task_WaitEventRet: call-type=CALLBACK
    Rte_Tick_Timeouts: call-type=REGULAR
    Rte_Trigger_APP_MOTOR_COMP_TR_BATT_LOW_set_low: call-type=REGULAR
    Rte_Trigger_APP_MOTOR_COMP_TR_BATT_LOW_set_normal: call-type=REGULAR
    Rte_Trigger_EngineApp_PhyGear_Pport_level{1..3}: call-type=REGULAR
    Rte_WaitWithTimeout: call-type=REGULAR
    Rte_WriteQueue: call-type=REGULAR
    Rte_Write_APP_BRAKE_CONTROLL_COMP_APP_FL_Mode_Send_modedata: call-type=REGULAR
    Rte_Write_APP_BRAKE_CONTROLL_COMP_APP_FR_Mode_Send_modedata: call-type=REGULAR
    Rte_Write_APP_BRAKE_CONTROLL_COMP_APP_RL_Mode_Send_modedata: call-type=REGULAR
    Rte_Write_APP_BRAKE_CONTROLL_COMP_APP_RR_Mode_Send_modedata: call-type=REGULAR
    Rte_Write_APP_MOTOR_COMP_SR_MOTOR_SPEED_Send_motor_speed_data: call-type=REGULAR
    Rte_Write_AccelControlAPP_P_EnginePower_powerValue: call-type=REGULAR
    Rte_Write_AccelControlAPP_P_PWM_pwm_data: call-type=REGULAR
    Rte_Write_AccelPedalSen_toApp_PPort_accel_value: call-type=REGULAR
    Rte_Write_AvgSpeed_P_avg_speed_avg_speed_data: call-type=REGULAR
    Rte_Write_BrakePedalSen_toApp_PPort_brake_value: call-type=REGULAR
    Rte_Write_Cylinder_Sen_Pport_pressure: call-type=REGULAR
    Rte_Write_Cylinder_Sen_Pport_temperature: call-type=REGULAR
    Rte_Write_EngineApp_CycleData_Pport_infoArray: call-type=REGULAR
    Rte_Write_GearModeSen_toApp_PPort_gear_value: call-type=REGULAR
    Rte_Write_SEN_BATT_COMP_SR_BATT_Send_batt_data: call-type=REGULAR
    Rte_Write_SpeedSen_toApp_PPort_backleft: call-type=REGULAR
    Rte_Write_SpeedSen_toApp_PPort_backright: call-type=REGULAR
    Rte_Write_SpeedSen_toApp_PPort_frontleft: call-type=REGULAR
    Rte_Write_SpeedSen_toApp_PPort_frontright: call-type=REGULAR
    Rte_memcpy: call-type=REGULAR
    SchM_Deinit: call-type=REGULAR
    SchM_Init: call-type=REGULAR
package /AUTOSAR_Rte/BswImplementations
  bsw implementation Rte: programming-language=C, sw-version=0.0.0, used-code-generator=ETAS RTEGen, ar-release-version=4.0.0, behavior=RteInternalBehavior
    generated-artifacts:
      142 x dependency on artifact:
        ACT_HYDRAULIC_MODULATOR_FRONTL_COMP_MemMap_h: artifact-descriptor={short-label=ACT_HYDRAULIC_MODULATOR_FRONTL_COMP_MemMap_h, category=SWHDR, domain=AUTOSAR}
        ACT_HYDRAULIC_MODULATOR_FRONTR_COMP_MemMap_h: artifact-descriptor={short-label=ACT_HYDRAULIC_MODULATOR_FRONTR_COMP_MemMap_h, category=SWHDR, domain=AUTOSAR}
        ACT_HYDRAULIC_MODULATOR_REARL_COMP_MemMap_h: artifact-descriptor={short-label=ACT_HYDRAULIC_MODULATOR_REARL_COMP_MemMap_h, category=SWHDR, domain=AUTOSAR}
        ACT_HYDRAULIC_MODULATOR_REARR_COMP_MemMap_h: artifact-descriptor={short-label=ACT_HYDRAULIC_MODULATOR_REARR_COMP_MemMap_h, category=SWHDR, domain=AUTOSAR}
        ACT_MOTOR_COMP_MemMap_h: artifact-descriptor={short-label=ACT_MOTOR_COMP_MemMap_h, category=SWHDR, domain=AUTOSAR}
        APP_BRAKE_CONTROLL_COMP_MemMap_h: artifact-descriptor={short-label=APP_BRAKE_CONTROLL_COMP_MemMap_h, category=SWHDR, domain=AUTOSAR}
        APP_MOTOR_COMP_MemMap_h: artifact-descriptor={short-label=APP_MOTOR_COMP_MemMap_h, category=SWHDR, domain=AUTOSAR}
        AccelControlAPP_MemMap_h: artifact-descriptor={short-label=AccelControlAPP_MemMap_h, category=SWHDR, domain=AUTOSAR}
        AccelPedalSen_MemMap_h: artifact-descriptor={short-label=AccelPedalSen_MemMap_h, category=SWHDR, domain=AUTOSAR}
        AvgSpeed_MemMap_h: artifact-descriptor={short-label=AvgSpeed_MemMap_h, category=SWHDR, domain=AUTOSAR}
        BrakePedalSen_MemMap_h: artifact-descriptor={short-label=BrakePedalSen_MemMap_h, category=SWHDR, domain=AUTOSAR}
        Com_h: artifact-descriptor={short-label=Com_h, category=SWHDR, domain=AUTOSAR}
        Cylinder_Sen_MemMap_h: artifact-descriptor={short-label=Cylinder_Sen_MemMap_h, category=SWHDR, domain=AUTOSAR}
        ECU_ABS_MemMap_h: artifact-descriptor={short-label=ECU_ABS_MemMap_h, category=SWHDR, domain=AUTOSAR}
        EngineApp_MemMap_h: artifact-descriptor={short-label=EngineApp_MemMap_h, category=SWHDR, domain=AUTOSAR}
        Engine_Cycle_ACT_MemMap_h: artifact-descriptor={short-label=Engine_Cycle_ACT_MemMap_h, category=SWHDR, domain=AUTOSAR}
        Engine_Gear_ACT_MemMap_h: artifact-descriptor={short-label=Engine_Gear_ACT_MemMap_h, category=SWHDR, domain=AUTOSAR}
        GearModeSen_MemMap_h: artifact-descriptor={short-label=GearModeSen_MemMap_h, category=SWHDR, domain=AUTOSAR}
        Ioc_h: artifact-descriptor={short-label=Ioc_h, category=SWHDR, domain=AUTOSAR}
        NvM_h: artifact-descriptor={short-label=NvM_h, category=SWHDR, domain=AUTOSAR}
        Os_h: artifact-descriptor={short-label=Os_h, category=SWHDR, domain=AUTOSAR}
        OsTask_0_c: artifact-descriptor={short-label=OsTask_0_c, category=SWSRC, domain=AUTOSAR}
        OsTask_0_h: artifact-descriptor={short-label=OsTask_0_h, category=SWHDR, domain=AUTOSAR}
        OsTask_04_c: artifact-descriptor={short-label=OsTask_04_c, category=SWSRC, domain=AUTOSAR}
        OsTask_04_h: artifact-descriptor={short-label=OsTask_04_h, category=SWHDR, domain=AUTOSAR}
        OsTask_1_c: artifact-descriptor={short-label=OsTask_1_c, category=SWSRC, domain=AUTOSAR}
        OsTask_1_h: artifact-descriptor={short-label=OsTask_1_h, category=SWHDR, domain=AUTOSAR}
        OsTask_10_c: artifact-descriptor={short-label=OsTask_10_c, category=SWSRC, domain=AUTOSAR}
        OsTask_10_h: artifact-descriptor={short-label=OsTask_10_h, category=SWHDR, domain=AUTOSAR}
        OsTask_11_c: artifact-descriptor={short-label=OsTask_11_c, category=SWSRC, domain=AUTOSAR}
        OsTask_11_h: artifact-descriptor={short-label=OsTask_11_h, category=SWHDR, domain=AUTOSAR}
        OsTask_12_c: artifact-descriptor={short-label=OsTask_12_c, category=SWSRC, domain=AUTOSAR}
        OsTask_12_h: artifact-descriptor={short-label=OsTask_12_h, category=SWHDR, domain=AUTOSAR}
        OsTask_13_c: artifact-descriptor={short-label=OsTask_13_c, category=SWSRC, domain=AUTOSAR}
        OsTask_13_h: artifact-descriptor={short-label=OsTask_13_h, category=SWHDR, domain=AUTOSAR}
        OsTask_14_c: artifact-descriptor={short-label=OsTask_14_c, category=SWSRC, domain=AUTOSAR}
        OsTask_14_h: artifact-descriptor={short-label=OsTask_14_h, category=SWHDR, domain=AUTOSAR}
        OsTask_15_c: artifact-descriptor={short-label=OsTask_15_c, category=SWSRC, domain=AUTOSAR}
        OsTask_15_h: artifact-descriptor={short-label=OsTask_15_h, category=SWHDR, domain=AUTOSAR}
        OsTask_16_c: artifact-descriptor={short-label=OsTask_16_c, category=SWSRC, domain=AUTOSAR}
        OsTask_16_h: artifact-descriptor={short-label=OsTask_16_h, category=SWHDR, domain=AUTOSAR}
        OsTask_18_c: artifact-descriptor={short-label=OsTask_18_c, category=SWSRC, domain=AUTOSAR}
        OsTask_18_h: artifact-descriptor={short-label=OsTask_18_h, category=SWHDR, domain=AUTOSAR}
        OsTask_19_c: artifact-descriptor={short-label=OsTask_19_c, category=SWSRC, domain=AUTOSAR}
        OsTask_19_h: artifact-descriptor={short-label=OsTask_19_h, category=SWHDR, domain=AUTOSAR}
        OsTask_2_c: artifact-descriptor={short-label=OsTask_2_c, category=SWSRC, domain=AUTOSAR}
        OsTask_2_h: artifact-descriptor={short-label=OsTask_2_h, category=SWHDR, domain=AUTOSAR}
        OsTask_20_c: artifact-descriptor={short-label=OsTask_20_c, category=SWSRC, domain=AUTOSAR}
        OsTask_20_h: artifact-descriptor={short-label=OsTask_20_h, category=SWHDR, domain=AUTOSAR}
        OsTask_21_c: artifact-descriptor={short-label=OsTask_21_c, category=SWSRC, domain=AUTOSAR}
        OsTask_21_h: artifact-descriptor={short-label=OsTask_21_h, category=SWHDR, domain=AUTOSAR}
        OsTask_22_c: artifact-descriptor={short-label=OsTask_22_c, category=SWSRC, domain=AUTOSAR}
        OsTask_22_h: artifact-descriptor={short-label=OsTask_22_h, category=SWHDR, domain=AUTOSAR}
        OsTask_23_c: artifact-descriptor={short-label=OsTask_23_c, category=SWSRC, domain=AUTOSAR}
        OsTask_23_h: artifact-descriptor={short-label=OsTask_23_h, category=SWHDR, domain=AUTOSAR}
        OsTask_24_c: artifact-descriptor={short-label=OsTask_24_c, category=SWSRC, domain=AUTOSAR}
        OsTask_24_h: artifact-descriptor={short-label=OsTask_24_h, category=SWHDR, domain=AUTOSAR}
        OsTask_25_c: artifact-descriptor={short-label=OsTask_25_c, category=SWSRC, domain=AUTOSAR}
        OsTask_25_h: artifact-descriptor={short-label=OsTask_25_h, category=SWHDR, domain=AUTOSAR}
        OsTask_26_c: artifact-descriptor={short-label=OsTask_26_c, category=SWSRC, domain=AUTOSAR}
        OsTask_26_h: artifact-descriptor={short-label=OsTask_26_h, category=SWHDR, domain=AUTOSAR}
        OsTask_3_c: artifact-descriptor={short-label=OsTask_3_c, category=SWSRC, domain=AUTOSAR}
        OsTask_3_h: artifact-descriptor={short-label=OsTask_3_h, category=SWHDR, domain=AUTOSAR}
        OsTask_5_c: artifact-descriptor={short-label=OsTask_5_c, category=SWSRC, domain=AUTOSAR}
        OsTask_5_h: artifact-descriptor={short-label=OsTask_5_h, category=SWHDR, domain=AUTOSAR}
        OsTask_6_c: artifact-descriptor={short-label=OsTask_6_c, category=SWSRC, domain=AUTOSAR}
        OsTask_6_h: artifact-descriptor={short-label=OsTask_6_h, category=SWHDR, domain=AUTOSAR}
        OsTask_7_c: artifact-descriptor={short-label=OsTask_7_c, category=SWSRC, domain=AUTOSAR}
        OsTask_7_h: artifact-descriptor={short-label=OsTask_7_h, category=SWHDR, domain=AUTOSAR}
        OsTask_8_c: artifact-descriptor={short-label=OsTask_8_c, category=SWSRC, domain=AUTOSAR}
        OsTask_8_h: artifact-descriptor={short-label=OsTask_8_h, category=SWHDR, domain=AUTOSAR}
        Rte_c: artifact-descriptor={short-label=Rte_c, category=SWSRC, domain=AUTOSAR}
        Rte_h: artifact-descriptor={short-label=Rte_h, category=SWHDR, domain=AUTOSAR}
        Rte_ACT_HYDRAULIC_MODULATOR_FRONTL_COMP_c: artifact-descriptor={short-label=Rte_ACT_HYDRAULIC_MODULATOR_FRONTL_COMP_c, category=SWSRC, domain=AUTOSAR}
        Rte_ACT_HYDRAULIC_MODULATOR_FRONTL_COMP_h: artifact-descriptor={short-label=Rte_ACT_HYDRAULIC_MODULATOR_FRONTL_COMP_h, category=SWHDR, domain=AUTOSAR}
        Rte_ACT_HYDRAULIC_MODULATOR_FRONTL_COMP_Type_h: artifact-descriptor={short-label=Rte_ACT_HYDRAULIC_MODULATOR_FRONTL_COMP_Type_h, category=SWHDR, domain=AUTOSAR}
        Rte_ACT_HYDRAULIC_MODULATOR_FRONTR_COMP_c: artifact-descriptor={short-label=Rte_ACT_HYDRAULIC_MODULATOR_FRONTR_COMP_c, category=SWSRC, domain=AUTOSAR}
        Rte_ACT_HYDRAULIC_MODULATOR_FRONTR_COMP_h: artifact-descriptor={short-label=Rte_ACT_HYDRAULIC_MODULATOR_FRONTR_COMP_h, category=SWHDR, domain=AUTOSAR}
        Rte_ACT_HYDRAULIC_MODULATOR_FRONTR_COMP_Type_h: artifact-descriptor={short-label=Rte_ACT_HYDRAULIC_MODULATOR_FRONTR_COMP_Type_h, category=SWHDR, domain=AUTOSAR}
        Rte_ACT_HYDRAULIC_MODULATOR_REARL_COMP_c: artifact-descriptor={short-label=Rte_ACT_HYDRAULIC_MODULATOR_REARL_COMP_c, category=SWSRC, domain=AUTOSAR}
        Rte_ACT_HYDRAULIC_MODULATOR_REARL_COMP_h: artifact-descriptor={short-label=Rte_ACT_HYDRAULIC_MODULATOR_REARL_COMP_h, category=SWHDR, domain=AUTOSAR}
        Rte_ACT_HYDRAULIC_MODULATOR_REARL_COMP_Type_h: artifact-descriptor={short-label=Rte_ACT_HYDRAULIC_MODULATOR_REARL_COMP_Type_h, category=SWHDR, domain=AUTOSAR}
        Rte_ACT_HYDRAULIC_MODULATOR_REARR_COMP_c: artifact-descriptor={short-label=Rte_ACT_HYDRAULIC_MODULATOR_REARR_COMP_c, category=SWSRC, domain=AUTOSAR}
        Rte_ACT_HYDRAULIC_MODULATOR_REARR_COMP_h: artifact-descriptor={short-label=Rte_ACT_HYDRAULIC_MODULATOR_REARR_COMP_h, category=SWHDR, domain=AUTOSAR}
        Rte_ACT_HYDRAULIC_MODULATOR_REARR_COMP_Type_h: artifact-descriptor={short-label=Rte_ACT_HYDRAULIC_MODULATOR_REARR_COMP_Type_h, category=SWHDR, domain=AUTOSAR}
        Rte_ACT_MOTOR_COMP_c: artifact-descriptor={short-label=Rte_ACT_MOTOR_COMP_c, category=SWSRC, domain=AUTOSAR}
        Rte_ACT_MOTOR_COMP_h: artifact-descriptor={short-label=Rte_ACT_MOTOR_COMP_h, category=SWHDR, domain=AUTOSAR}
        Rte_ACT_MOTOR_COMP_Type_h: artifact-descriptor={short-label=Rte_ACT_MOTOR_COMP_Type_h, category=SWHDR, domain=AUTOSAR}
        Rte_APP_BRAKE_CONTROLL_COMP_c: artifact-descriptor={short-label=Rte_APP_BRAKE_CONTROLL_COMP_c, category=SWSRC, domain=AUTOSAR}
        Rte_APP_BRAKE_CONTROLL_COMP_h: artifact-descriptor={short-label=Rte_APP_BRAKE_CONTROLL_COMP_h, category=SWHDR, domain=AUTOSAR}
        Rte_APP_BRAKE_CONTROLL_COMP_Type_h: artifact-descriptor={short-label=Rte_APP_BRAKE_CONTROLL_COMP_Type_h, category=SWHDR, domain=AUTOSAR}
        Rte_APP_MOTOR_COMP_c: artifact-descriptor={short-label=Rte_APP_MOTOR_COMP_c, category=SWSRC, domain=AUTOSAR}
        Rte_APP_MOTOR_COMP_h: artifact-descriptor={short-label=Rte_APP_MOTOR_COMP_h, category=SWHDR, domain=AUTOSAR}
        Rte_APP_MOTOR_COMP_Type_h: artifact-descriptor={short-label=Rte_APP_MOTOR_COMP_Type_h, category=SWHDR, domain=AUTOSAR}
        Rte_AccelControlAPP_c: artifact-descriptor={short-label=Rte_AccelControlAPP_c, category=SWSRC, domain=AUTOSAR}
        Rte_AccelControlAPP_h: artifact-descriptor={short-label=Rte_AccelControlAPP_h, category=SWHDR, domain=AUTOSAR}
        Rte_AccelControlAPP_Type_h: artifact-descriptor={short-label=Rte_AccelControlAPP_Type_h, category=SWHDR, domain=AUTOSAR}
        Rte_AccelPedalSen_c: artifact-descriptor={short-label=Rte_AccelPedalSen_c, category=SWSRC, domain=AUTOSAR}
        Rte_AccelPedalSen_h: artifact-descriptor={short-label=Rte_AccelPedalSen_h, category=SWHDR, domain=AUTOSAR}
        Rte_AccelPedalSen_Type_h: artifact-descriptor={short-label=Rte_AccelPedalSen_Type_h, category=SWHDR, domain=AUTOSAR}
        Rte_AvgSpeed_c: artifact-descriptor={short-label=Rte_AvgSpeed_c, category=SWSRC, domain=AUTOSAR}
        Rte_AvgSpeed_h: artifact-descriptor={short-label=Rte_AvgSpeed_h, category=SWHDR, domain=AUTOSAR}
        Rte_AvgSpeed_Type_h: artifact-descriptor={short-label=Rte_AvgSpeed_Type_h, category=SWHDR, domain=AUTOSAR}
        Rte_BrakePedalSen_c: artifact-descriptor={short-label=Rte_BrakePedalSen_c, category=SWSRC, domain=AUTOSAR}
        Rte_BrakePedalSen_h: artifact-descriptor={short-label=Rte_BrakePedalSen_h, category=SWHDR, domain=AUTOSAR}
        Rte_BrakePedalSen_Type_h: artifact-descriptor={short-label=Rte_BrakePedalSen_Type_h, category=SWHDR, domain=AUTOSAR}
        Rte_Cbk_h: artifact-descriptor={short-label=Rte_Cbk_h, category=SWHDR, domain=AUTOSAR}
        Rte_Cfg_h: artifact-descriptor={short-label=Rte_Cfg_h, category=SWHDR, domain=AUTOSAR}
        Rte_Const_h: artifact-descriptor={short-label=Rte_Const_h, category=SWHDR, domain=AUTOSAR}
        Rte_Cylinder_Sen_c: artifact-descriptor={short-label=Rte_Cylinder_Sen_c, category=SWSRC, domain=AUTOSAR}
        Rte_Cylinder_Sen_h: artifact-descriptor={short-label=Rte_Cylinder_Sen_h, category=SWHDR, domain=AUTOSAR}
        Rte_Cylinder_Sen_Type_h: artifact-descriptor={short-label=Rte_Cylinder_Sen_Type_h, category=SWHDR, domain=AUTOSAR}
        Rte_DataHandleType_h: artifact-descriptor={short-label=Rte_DataHandleType_h, category=SWHDR, domain=AUTOSAR}
        Rte_ECU_ABS_c: artifact-descriptor={short-label=Rte_ECU_ABS_c, category=SWSRC, domain=AUTOSAR}
        Rte_ECU_ABS_h: artifact-descriptor={short-label=Rte_ECU_ABS_h, category=SWHDR, domain=AUTOSAR}
        Rte_ECU_ABS_Type_h: artifact-descriptor={short-label=Rte_ECU_ABS_Type_h, category=SWHDR, domain=AUTOSAR}
        Rte_EngineApp_c: artifact-descriptor={short-label=Rte_EngineApp_c, category=SWSRC, domain=AUTOSAR}
        Rte_EngineApp_h: artifact-descriptor={short-label=Rte_EngineApp_h, category=SWHDR, domain=AUTOSAR}
        Rte_EngineApp_Type_h: artifact-descriptor={short-label=Rte_EngineApp_Type_h, category=SWHDR, domain=AUTOSAR}
        Rte_Engine_Cycle_ACT_c: artifact-descriptor={short-label=Rte_Engine_Cycle_ACT_c, category=SWSRC, domain=AUTOSAR}
        Rte_Engine_Cycle_ACT_h: artifact-descriptor={short-label=Rte_Engine_Cycle_ACT_h, category=SWHDR, domain=AUTOSAR}
        Rte_Engine_Cycle_ACT_Type_h: artifact-descriptor={short-label=Rte_Engine_Cycle_ACT_Type_h, category=SWHDR, domain=AUTOSAR}
        Rte_Engine_Gear_ACT_c: artifact-descriptor={short-label=Rte_Engine_Gear_ACT_c, category=SWSRC, domain=AUTOSAR}
        Rte_Engine_Gear_ACT_h: artifact-descriptor={short-label=Rte_Engine_Gear_ACT_h, category=SWHDR, domain=AUTOSAR}
        Rte_Engine_Gear_ACT_Type_h: artifact-descriptor={short-label=Rte_Engine_Gear_ACT_Type_h, category=SWHDR, domain=AUTOSAR}
        Rte_GearModeSen_c: artifact-descriptor={short-label=Rte_GearModeSen_c, category=SWSRC, domain=AUTOSAR}
        Rte_GearModeSen_h: artifact-descriptor={short-label=Rte_GearModeSen_h, category=SWHDR, domain=AUTOSAR}
        Rte_GearModeSen_Type_h: artifact-descriptor={short-label=Rte_GearModeSen_Type_h, category=SWHDR, domain=AUTOSAR}
        Rte_Hook_h: artifact-descriptor={short-label=Rte_Hook_h, category=SWHDR, domain=AUTOSAR}
        Rte_Intl_h: artifact-descriptor={short-label=Rte_Intl_h, category=SWHDR, domain=AUTOSAR}
        Rte_Lib_c: artifact-descriptor={short-label=Rte_Lib_c, category=SWSRC, domain=AUTOSAR}
        Rte_Main_h: artifact-descriptor={short-label=Rte_Main_h, category=SWHDR, domain=AUTOSAR}
        Rte_MemMap_h: artifact-descriptor={short-label=Rte_MemMap_h, category=SWHDR, domain=AUTOSAR}
        Rte_SEN_BATT_COMP_c: artifact-descriptor={short-label=Rte_SEN_BATT_COMP_c, category=SWSRC, domain=AUTOSAR}
        Rte_SEN_BATT_COMP_h: artifact-descriptor={short-label=Rte_SEN_BATT_COMP_h, category=SWHDR, domain=AUTOSAR}
        Rte_SEN_BATT_COMP_Type_h: artifact-descriptor={short-label=Rte_SEN_BATT_COMP_Type_h, category=SWHDR, domain=AUTOSAR}
        Rte_SpeedSen_c: artifact-descriptor={short-label=Rte_SpeedSen_c, category=SWSRC, domain=AUTOSAR}
        Rte_SpeedSen_h: artifact-descriptor={short-label=Rte_SpeedSen_h, category=SWHDR, domain=AUTOSAR}
        Rte_SpeedSen_Type_h: artifact-descriptor={short-label=Rte_SpeedSen_Type_h, category=SWHDR, domain=AUTOSAR}
        Rte_Type_h: artifact-descriptor={short-label=Rte_Type_h, category=SWHDR, domain=AUTOSAR}
        SEN_BATT_COMP_MemMap_h: artifact-descriptor={short-label=SEN_BATT_COMP_MemMap_h, category=SWHDR, domain=AUTOSAR}
        SpeedSen_MemMap_h: artifact-descriptor={short-label=SpeedSen_MemMap_h, category=SWHDR, domain=AUTOSAR}
    resource consumption ResConsumption
      9 x memory section:
        CODE: executable-entity=[Rte_ActivateRE, Rte_Call_ACT_HYDRAULIC_MODULATOR_FRONTL_COMP_ACT_HM_FL_Client_set_E_op, Rte_Call_ACT_HYDRAULIC_MODULATOR_FRONTR_COMP_ACT_HM_FR_Client_set_E_op, Rte_Call_ACT_HYDRAULIC_MODULATOR_REARL_COMP_ACT_HM_RL_Client_set_E_op, Rte_Call_ACT_HYDRAULIC_MODULATOR_REARR_COMP_ACT_HM_RR_Client_set_E_op, Rte_Call_ACT_MOTOR_COMP_CS_MOTOR_Client_motor_act_op, Rte_Call_AccelPedalSen_RPort_get_AccelPedal_Status, Rte_Call_BrakePedalSen_RPort_get_BrakePedal_Status, Rte_Call_Cylinder_Sen_Rport_get_cylinder_Status, Rte_Call_Engine_Cycle_ACT_Engine_Cleintport_set_engine, Rte_Call_Engine_Gear_ACT_phyGear_relayPport_set_phygear, Rte_Call_GearModeSen_RPort_get_Gear_Mode, Rte_Call_SEN_BATT_COMP_CS_BATT_Receive_batt_sen_op, Rte_Call_SpeedSen_RPort_get_Tire_RPM, Rte_DRead_ACT_HYDRAULIC_MODULATOR_FRONTL_COMP_ACT_HM_FL_Recv_modedata, Rte_DRead_ACT_HYDRAULIC_MODULATOR_FRONTR_COMP_ACT_HM_FR_Recv_modedata, Rte_DRead_ACT_HYDRAULIC_MODULATOR_REARL_COMP_ACT_HM_RL_Recv_modedata, Rte_DRead_ACT_HYDRAULIC_MODULATOR_REARR_COMP_ACT_HM_RR_Recv_modedata, Rte_DRead_ACT_MOTOR_COMP_SR_MOTOR_SPEED_Recv_motor_speed_data, Rte_DRead_APP_BRAKE_CONTROLL_COMP_APP_Speed_Receive_backleft, Rte_DRead_APP_BRAKE_CONTROLL_COMP_APP_Speed_Receive_backright, Rte_DRead_APP_BRAKE_CONTROLL_COMP_APP_Speed_Receive_frontleft, Rte_DRead_APP_BRAKE_CONTROLL_COMP_APP_Speed_Receive_frontright, Rte_DRead_APP_MOTOR_COMP_SR_BATT_Recv_batt_data, Rte_DRead_APP_MOTOR_COMP_SR_PWM_Recv_pwm_data, Rte_DRead_AccelControlAPP_R_Accel_accel_value, Rte_DRead_AccelControlAPP_R_AvgSpeed_avg_speed_data, Rte_DRead_AccelControlAPP_R_Brake_brake_value, Rte_DRead_AccelControlAPP_R_Gear_gear_value, Rte_DRead_AvgSpeed_R_4speeds_backleft, Rte_DRead_AvgSpeed_R_4speeds_backright, Rte_DRead_AvgSpeed_R_4speeds_frontleft, Rte_DRead_AvgSpeed_R_4speeds_frontright, Rte_DRead_EngineApp_Cylinder_Rport_pressure, Rte_DRead_EngineApp_Cylinder_Rport_temperature, Rte_DRead_EngineApp_Power_Rport_powerValue, Rte_DecrementWaitingCount, Rte_GetCurrentTaskIndex, Rte_MainFunction, Rte_ReadQueue, Rte_Read_Engine_Cycle_ACT_CycleData_Rport_infoArray, Rte_SetEvent, Rte_Start, Rte_Stop, Rte_Tick_Timeouts, Rte_Trigger_APP_MOTOR_COMP_TR_BATT_LOW_set_low, Rte_Trigger_APP_MOTOR_COMP_TR_BATT_LOW_set_normal, Rte_Trigger_EngineApp_PhyGear_Pport_level1, Rte_Trigger_EngineApp_PhyGear_Pport_level2, Rte_Trigger_EngineApp_PhyGear_Pport_level3, Rte_WaitWithTimeout, Rte_WriteQueue, Rte_Write_APP_BRAKE_CONTROLL_COMP_APP_FL_Mode_Send_modedata, Rte_Write_APP_BRAKE_CONTROLL_COMP_APP_FR_Mode_Send_modedata, Rte_Write_APP_BRAKE_CONTROLL_COMP_APP_RL_Mode_Send_modedata, Rte_Write_APP_BRAKE_CONTROLL_COMP_APP_RR_Mode_Send_modedata, Rte_Write_APP_MOTOR_COMP_SR_MOTOR_SPEED_Send_motor_speed_data, Rte_Write_AccelControlAPP_P_EnginePower_powerValue, Rte_Write_AccelControlAPP_P_PWM_pwm_data, Rte_Write_AccelPedalSen_toApp_PPort_accel_value, Rte_Write_AvgSpeed_P_avg_speed_avg_speed_data, Rte_Write_BrakePedalSen_toApp_PPort_brake_value, Rte_Write_Cylinder_Sen_Pport_pressure, Rte_Write_Cylinder_Sen_Pport_temperature, Rte_Write_EngineApp_CycleData_Pport_infoArray, Rte_Write_GearModeSen_toApp_PPort_gear_value, Rte_Write_SEN_BATT_COMP_SR_BATT_Send_batt_data, Rte_Write_SpeedSen_toApp_PPort_backleft, Rte_Write_SpeedSen_toApp_PPort_backright, Rte_Write_SpeedSen_toApp_PPort_frontleft, Rte_Write_SpeedSen_toApp_PPort_frontright, Rte_memcpy, SchM_Deinit, SchM_Init], sw-addrmethod=CODE
        CONST_UNSPECIFIED: alignment=UNSPECIFIED, sw-addrmethod=CONST
        VAR_CLEARED_16: alignment=16, sw-addrmethod=VAR_CLEARED
        VAR_CLEARED_32: alignment=32, sw-addrmethod=VAR_CLEARED
        VAR_CLEARED_64: alignment=64, sw-addrmethod=VAR_CLEARED
        VAR_CLEARED_8: alignment=8, sw-addrmethod=VAR_CLEARED
        VAR_CLEARED_BOOLEAN: alignment=BOOLEAN, sw-addrmethod=VAR_CLEARED
        VAR_CLEARED_UNSPECIFIED: alignment=UNSPECIFIED, sw-addrmethod=VAR_CLEARED
        VAR_INIT_UNSPECIFIED: alignment=UNSPECIFIED, sw-addrmethod=VAR_INIT
package /AUTOSAR_Rte/DataConstrs
  range DataConstraints_DataConstr_uint8: phys 0..255, raw 0..255
  range DataConstraints_DataConstr_sint8: phys -128..127, raw -128..127
  range DataConstraints_DataConstr_sint16: phys -32768..32767, raw -32768..32767
  range DataConstraints_DataConstr_boolean: phys 0..1, raw 0..1
package /AUTOSAR_Rte/ImplementationDataTypes
  75 x impl type:
    Rte_REActCounterType: category=VALUE  # This is an external type, i.e. it is declared in the Rte Library and not in the XML. RTEGen does not have any information about this type apart from its name.
    Rte_WaitableDatum: category=VALUE  # This is an external type, i.e. it is declared in the Rte Library and not in the XML. RTEGen does not have any information about this type apart from its name.
    Rte_CDS_ACT_HYDRAULIC_MODULATOR_FRONTL_COMP: category=STRUCTURE
      element _dummy: implementation-data-type=uint8
    Rte_CDS_ACT_HYDRAULIC_MODULATOR_FRONTR_COMP: category=STRUCTURE
      element _dummy: implementation-data-type=uint8
    Rte_CDS_ACT_HYDRAULIC_MODULATOR_REARL_COMP: category=STRUCTURE
      element _dummy: implementation-data-type=uint8
    Rte_CDS_ACT_HYDRAULIC_MODULATOR_REARR_COMP: category=STRUCTURE
      element _dummy: implementation-data-type=uint8
    Rte_CDS_ACT_MOTOR_COMP: category=STRUCTURE
      element _dummy: implementation-data-type=uint8
    Rte_CDS_APP_BRAKE_CONTROLL_COMP: category=STRUCTURE
      element _dummy: implementation-data-type=uint8
    Rte_CDS_APP_MOTOR_COMP: category=STRUCTURE
      element _dummy: implementation-data-type=uint8
    Rte_CDS_AccelControlAPP: category=STRUCTURE
      element _dummy: implementation-data-type=uint8
    Rte_CDS_AccelPedalSen: category=STRUCTURE
      element _dummy: implementation-data-type=uint8
    Rte_CDS_AvgSpeed: category=STRUCTURE
      element _dummy: implementation-data-type=uint8
    Rte_CDS_BrakePedalSen: category=STRUCTURE
      element _dummy: implementation-data-type=uint8
    Rte_CDS_Cylinder_Sen: category=STRUCTURE
      element _dummy: implementation-data-type=uint8
    Rte_CDS_ECU_ABS: category=STRUCTURE
      element _dummy: implementation-data-type=uint8
    Rte_CDS_EngineApp: category=STRUCTURE
      element _dummy: implementation-data-type=uint8
    Rte_CDS_Engine_Cycle_ACT: category=STRUCTURE
      element _dummy: implementation-data-type=uint8
    Rte_CDS_Engine_Gear_ACT: category=STRUCTURE
      element _dummy: implementation-data-type=uint8
    Rte_CDS_GearModeSen: category=STRUCTURE
      element _dummy: implementation-data-type=uint8
    Rte_CDS_SEN_BATT_COMP: category=STRUCTURE
      element _dummy: implementation-data-type=uint8
    Rte_CDS_SpeedSen: category=STRUCTURE
      element _dummy: implementation-data-type=uint8
    Rte_QWWPType: category=VALUE  # This is an external type, i.e. it is declared in the Rte Library and not in the XML. RTEGen does not have any information about this type apart from its name.
    Rte_CPT_ECU_ABS_PHMFrontL_set_E_op_RtnQEType: category=STRUCTURE
      element dummy: implementation-data-type=uint8
    Rte_QDynType: category=VALUE  # This is an external type, i.e. it is declared in the Rte Library and not in the XML. RTEGen does not have any information about this type apart from its name.
    Rte_WOWP_NotificationType: category=VALUE  # This is an external type, i.e. it is declared in the Rte Library and not in the XML. RTEGen does not have any information about this type apart from its name.
    Rte_CPT_ECU_ABS_PHMFrontR_set_E_op_RtnQEType: category=STRUCTURE
      element dummy: implementation-data-type=uint8
    Rte_CPT_ECU_ABS_PHMRearL_set_E_op_RtnQEType: category=STRUCTURE
      element dummy: implementation-data-type=uint8
    Rte_CPT_ECU_ABS_PHMRearR_set_E_op_RtnQEType: category=STRUCTURE
      element dummy: implementation-data-type=uint8
    Rte_CPT_ECU_ABS_CS_MOTOR_Server_motor_act_op_RtnQEType: category=STRUCTURE
      element dummy: implementation-data-type=uint8
    Rte_CPT_ECU_ABS_PAccelPedal_get_AccelPedal_Status_RtnQEType: category=STRUCTURE
      element status: implementation-data-type=sint8
    Rte_CPT_ECU_ABS_PBrakePedal_get_BrakePedal_Status_RtnQEType: category=STRUCTURE
      element status: implementation-data-type=sint8
    Rte_CPT_ECU_ABS_PCylinder_get_cylinder_Status_RtnQEType: category=STRUCTURE
      element temperature: implementation-data-type=sint16
      element pressure: implementation-data-type=sint16
    Rte_QTaskType: category=VALUE  # This is an external type, i.e. it is declared in the Rte Library and not in the XML. RTEGen does not have any information about this type apart from its name.
    Rte_QCmnRefType: category=VALUE  # This is an external type, i.e. it is declared in the Rte Library and not in the XML. RTEGen does not have any information about this type apart from its name.
    Rte_CPT_ECU_ABS_ActSEngine_set_engine_QEType: category=STRUCTURE
      4 x element, all with category=TYPE_REFERENCE:
        is_on: implementation-data-type=sint8
        ignite: implementation-data-type=boolean
        fuel_input: implementation-data-type=sint8
        clientQueue: implementation-data-type=Rte_QCmnRefType
    Rte_CPT_ECU_ABS_ActSGear_set_phygear_QEType: category=STRUCTURE
      element gear_value: implementation-data-type=sint8
      element clientQueue: implementation-data-type=Rte_QCmnRefType
    Rte_CPT_ECU_ABS_CS_BATT_Server_batt_sen_op_QEType: category=STRUCTURE
      element clientQueue: implementation-data-type=Rte_QCmnRefType
    Rte_CPT_ECU_ABS_CS_MOTOR_Server_motor_act_op_QEType: category=STRUCTURE
      element motor_act_data: implementation-data-type=sint16
      element clientQueue: implementation-data-type=Rte_QCmnRefType
    Rte_CPT_ECU_ABS_PAccelPedal_get_AccelPedal_Status_QEType: category=STRUCTURE
      element clientQueue: implementation-data-type=Rte_QCmnRefType
    Rte_CPT_ECU_ABS_PBrakePedal_get_BrakePedal_Status_QEType: category=STRUCTURE
      element clientQueue: implementation-data-type=Rte_QCmnRefType
    Rte_CPT_ECU_ABS_PCylinder_get_cylinder_Status_QEType: category=STRUCTURE
      element clientQueue: implementation-data-type=Rte_QCmnRefType
    Rte_CPT_ECU_ABS_PGearMode_get_Gear_Mode_QEType: category=STRUCTURE
      element clientQueue: implementation-data-type=Rte_QCmnRefType
    Rte_CPT_ECU_ABS_PHMFrontL_set_E_op_QEType: category=STRUCTURE
      element volt: implementation-data-type=sint16
      element clientQueue: implementation-data-type=Rte_QCmnRefType
    Rte_CPT_ECU_ABS_PHMFrontR_set_E_op_QEType: category=STRUCTURE
      element volt: implementation-data-type=sint16
      element clientQueue: implementation-data-type=Rte_QCmnRefType
    Rte_CPT_ECU_ABS_PHMRearL_set_E_op_QEType: category=STRUCTURE
      element volt: implementation-data-type=sint16
      element clientQueue: implementation-data-type=Rte_QCmnRefType
    Rte_CPT_ECU_ABS_PHMRearR_set_E_op_QEType: category=STRUCTURE
      element volt: implementation-data-type=sint16
      element clientQueue: implementation-data-type=Rte_QCmnRefType
    Rte_CPT_ECU_ABS_PTireRPM_get_Tire_RPM_QEType: category=STRUCTURE
      element clientQueue: implementation-data-type=Rte_QCmnRefType
    Rte_CPT_ECU_ABS_ActSEngine_set_engine_RtnQEType: category=STRUCTURE
      element dummy: implementation-data-type=uint8
    Rte_CPT_ECU_ABS_ActSGear_set_phygear_RtnQEType: category=STRUCTURE
      element dummy: implementation-data-type=uint8
    Rte_CPT_ECU_ABS_PGearMode_get_Gear_Mode_RtnQEType: category=STRUCTURE
      element gear_mode: implementation-data-type=sint8
    Rte_CPT_ECU_ABS_CS_BATT_Server_batt_sen_op_RtnQEType: category=STRUCTURE
      element batt_sen_data: implementation-data-type=uint8
    Rte_CPT_ECU_ABS_PTireRPM_get_Tire_RPM_RtnQEType: category=STRUCTURE
      4 x element, all with category=TYPE_REFERENCE, implementation-data-type=sint16:
        frontleft
        frontright
        backleft
        backright
    arr_sint8: category=ARRAY
      element arr_sint8Element: array-size=5, array-size-semantics=FIXED-SIZE, implementation-data-type=sint8
    Rte_SelfType_ACT_HYDRAULIC_MODULATOR_FRONTL_COMP: implementation-data-type=Rte_CDS_ACT_HYDRAULIC_MODULATOR_FRONTL_COMP
    Rte_SelfType_ACT_HYDRAULIC_MODULATOR_FRONTR_COMP: implementation-data-type=Rte_CDS_ACT_HYDRAULIC_MODULATOR_FRONTR_COMP
    Rte_SelfType_ACT_HYDRAULIC_MODULATOR_REARL_COMP: implementation-data-type=Rte_CDS_ACT_HYDRAULIC_MODULATOR_REARL_COMP
    Rte_SelfType_ACT_HYDRAULIC_MODULATOR_REARR_COMP: implementation-data-type=Rte_CDS_ACT_HYDRAULIC_MODULATOR_REARR_COMP
    Rte_SelfType_ACT_MOTOR_COMP: implementation-data-type=Rte_CDS_ACT_MOTOR_COMP
    Rte_SelfType_APP_BRAKE_CONTROLL_COMP: implementation-data-type=Rte_CDS_APP_BRAKE_CONTROLL_COMP
    Rte_SelfType_APP_MOTOR_COMP: implementation-data-type=Rte_CDS_APP_MOTOR_COMP
    Rte_SelfType_AccelControlAPP: implementation-data-type=Rte_CDS_AccelControlAPP
    Rte_SelfType_AccelPedalSen: implementation-data-type=Rte_CDS_AccelPedalSen
    Rte_SelfType_AvgSpeed: implementation-data-type=Rte_CDS_AvgSpeed
    Rte_SelfType_BrakePedalSen: implementation-data-type=Rte_CDS_BrakePedalSen
    Rte_SelfType_Cylinder_Sen: implementation-data-type=Rte_CDS_Cylinder_Sen
    Rte_SelfType_ECU_ABS: implementation-data-type=Rte_CDS_ECU_ABS
    Rte_SelfType_EngineApp: implementation-data-type=Rte_CDS_EngineApp
    Rte_SelfType_Engine_Cycle_ACT: implementation-data-type=Rte_CDS_Engine_Cycle_ACT
    Rte_SelfType_Engine_Gear_ACT: implementation-data-type=Rte_CDS_Engine_Gear_ACT
    Rte_SelfType_GearModeSen: implementation-data-type=Rte_CDS_GearModeSen
    Rte_SelfType_SEN_BATT_COMP: implementation-data-type=Rte_CDS_SEN_BATT_COMP
    Rte_SelfType_SpeedSen: implementation-data-type=Rte_CDS_SpeedSen
    Rte_TaskInfo: category=VALUE  # This is an external type, i.e. it is declared in the Rte Library and not in the XML. RTEGen does not have any information about this type apart from its name.
    Rte_AlarmRefType: category=VALUE  # This is an external type, i.e. it is declared in the Rte Library and not in the XML. RTEGen does not have any information about this type apart from its name.
    Rte_EventType: category=VALUE  # This is an external type, i.e. it is declared in the Rte Library and not in the XML. RTEGen does not have any information about this type apart from its name.
package /AUTOSAR_Rte/SwAddrMethods
  4 x sw addr method:
    CODE: memory-allocation-keyword-policy=ADDR-METHOD-SHORT-NAME, section-type=CODE
    CONST: memory-allocation-keyword-policy=ADDR-METHOD-SHORT-NAME-AND-ALIGNMENT, section-type=CONST
    VAR_CLEARED: memory-allocation-keyword-policy=ADDR-METHOD-SHORT-NAME-AND-ALIGNMENT, section-initialization-policy=CLEARED, section-type=VAR
    VAR_INIT: memory-allocation-keyword-policy=ADDR-METHOD-SHORT-NAME-AND-ALIGNMENT, section-initialization-policy=INIT, section-type=VAR
