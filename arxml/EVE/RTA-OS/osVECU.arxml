AUTOSAR XML (schema 4-0-3)
package /OS
  module config OS_CFG: definition=Os
    OSDEFAULTAPPMODE (OsAppMode)
    RTE_RESOURCE (OsResource)
    OsInfo (OsOS):
      OsScalabilityClass = SC1
      OsStatus = STANDARD
      OsStackMonitoring = false
      OsUseGetServiceId = false
      OsUseParameterAccess = false
      OsUseResScheduler = true
      OsCyclesPerSecond = 1000000
      OsTicksPerSecond = 1000
      OsNumberOfCores = 1
      HooksContainer (OsHooks): OsStartupHook=true, OsShutdownHook=true, OsPreTaskHook=false, OsPostTaskHook=false, OsStackFaultHook=false, OsProtectionHook=false, OsErrorHook=false
      meter_execution (Param): Value=false
      no_timing_protection (Param): Value=false
    VECU_SystemClock_ISR (OsIsr): OsIsrCategory=CATEGORY_2, OsIsrPriority=5, OsIsrAddress=7
    OsRTATarget: OsRTATargetName=VRTA, OsRTATargetVersion=3.0.41, OsRTATargetVariant=MinGW
      SpECC (Param): Value=4096
    25 x OsTask, all with OsTaskStackAllocation=128, OsTaskWaitStack=128:
      OsTask_0
      OsTask_04
      OsTask_1
      OsTask_{10..16}
      OsTask_18
      OsTask_19
      OsTask_2
      OsTask_{20..26}
      OsTask_3
      OsTask_{5..8}
