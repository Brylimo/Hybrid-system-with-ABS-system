AUTOSAR XML (schema 4-0-3)
package /VRSYS
  system Vrsys: category=SYSTEM_EXTRACT, system-version=1.0.0
    system mapping SystemMapping_0
      sw-mappings:
        swc to ecu mapping SwcToEcuMapping_0: ecu-instance=EcuInstance_0
          component:
            RootSwCompositionPrototype_0.CPT_AComposition
            RootSwCompositionPrototype_0.CPT_BRAKE_COMPOSITION
            RootSwCompositionPrototype_0.CPT_ECU_ABS
            RootSwCompositionPrototype_0.CPT_Engine_Composition
            RootSwCompositionPrototype_0.CPT_MotorComposition
            RootSwCompositionPrototype_0.CPT_SpeedSen
    root-software-compositions:
      root sw composition prototype RootSwCompositionPrototype_0: software-composition=TopLevelComposition
  ecu instance EcuInstance_0
  ecuc value collection EcucValueCollection_0: ecu-extract=EXTR_EcuInstance_0, ecuc-values=[OS_CFG, RTE_CFG]
  module config RTE_CFG: definition=Rte
    RteGeneration_0 (RteGeneration):
      RteGenerationMode = VENDOR_MODE
      RteCalibrationSupport = NONE
      RteDevErrorDetect = false
      RteDevErrorDetectUninit = false
      RteGenerationMode = VENDOR_MODE
      RteMeasurementSupport = true
      RteOptimizationMode = RUNTIME
      RteToolChainSignificantCharacters = 127
      RteVfbTraceEnabled = false
    19 x RteSwComponentInstance:
      CPT_ECU_ABS: RteSoftwareComponentInstanceRef=CPT_ECU_ABS
        13 x RteEventToTaskMapping, all with RteActivationOffset=0.0, RteMappedToTaskRef=OsTask_0:
          OperationInvokedEvent_11: RtePositionInTask=13, RteEventRef=OperationInvokedEvent_11
          OperationInvokedEvent_4: RtePositionInTask=12, RteEventRef=OperationInvokedEvent_4
          OperationInvokedEvent_6: RtePositionInTask=11, RteEventRef=OperationInvokedEvent_6
          OperationInvokedEvent_8: RtePositionInTask=10, RteEventRef=OperationInvokedEvent_8
          OperationInvokedEvent_2: RtePositionInTask=9, RteEventRef=OperationInvokedEvent_2
          OperationInvokedEvent_7: RtePositionInTask=8, RteEventRef=OperationInvokedEvent_7
          OperationInvokedEvent_9: RtePositionInTask=7, RteEventRef=OperationInvokedEvent_9
          OperationInvokedEvent_5: RtePositionInTask=6, RteEventRef=OperationInvokedEvent_5
          OperationInvokedEvent_1: RtePositionInTask=5, RteEventRef=OperationInvokedEvent_1
          OperationInvokedEvent_3: RtePositionInTask=4, RteEventRef=OperationInvokedEvent_3
          OperationInvokedEvent_0: RtePositionInTask=3, RteEventRef=OperationInvokedEvent_0
          OperationInvokedEvent_10: RtePositionInTask=2, RteEventRef=OperationInvokedEvent_10
          OperationInvokedEvent_12: RtePositionInTask=1, RteEventRef=OperationInvokedEvent_12
      CPT_SpeedSen: RteSoftwareComponentInstanceRef=CPT_SpeedSen
        SpeedSensorEvnet (RteEventToTaskMapping): RtePositionInTask=1, RteActivationOffset=0.0, RteMappedToTaskRef=OsTask_1, RteEventRef=SpeedSensorEvnet
      CPT_SEN_BATT_COMP: RteSoftwareComponentInstanceRef=CPT_SEN_BATT_COMP
        TE_100ms (RteEventToTaskMapping): RtePositionInTask=1, RteActivationOffset=0.0, RteMappedToTaskRef=OsTask_04, RteEventRef=TE_300ms
      CPT_GearModeSen: RteSoftwareComponentInstanceRef=CPT_GearModeSen
        TimingEvent_0 (RteEventToTaskMapping): RtePositionInTask=1, RteActivationOffset=0.0, RteMappedToTaskRef=OsTask_10, RteEventRef=TimingEvent_0
      CPT_BrakePedalSen: RteSoftwareComponentInstanceRef=CPT_BrakePedalSen
        TimingEvent_0 (RteEventToTaskMapping): RtePositionInTask=1, RteActivationOffset=0.0, RteMappedToTaskRef=OsTask_11, RteEventRef=TimingEvent_0
      CPT_AccelPedalSen: RteSoftwareComponentInstanceRef=CPT_AccelPedalSen
        TimingEvent_0 (RteEventToTaskMapping): RtePositionInTask=1, RteActivationOffset=0.0, RteMappedToTaskRef=OsTask_12, RteEventRef=TimingEvent_0
      CPT_AccelControlAPP: RteSoftwareComponentInstanceRef=CPT_AccelControlAPP
        3 x RteEventToTaskMapping, all with RteActivationOffset=0.0:
          TimingEvent_0: RtePositionInTask=3, RteMappedToTaskRef=OsTask_13, RteEventRef=TimingEvent_0
          ExternalTriggerOccurredEvent_1: RtePositionInTask=1, RteMappedToTaskRef=OsTask_5, RteEventRef=ExternalTriggerOccurredEvent_1
          ExternalTriggerOccurredEvent_0: RtePositionInTask=1, RteMappedToTaskRef=OsTask_8, RteEventRef=ExternalTriggerOccurredEvent_0
      CPT_ACT_HYDRAULIC_MODULATOR_REARR_COMP: RteSoftwareComponentInstanceRef=CPT_ACT_HYDRAULIC_MODULATOR_REARR_COMP
        DataReceivedEvent_0 (RteEventToTaskMapping): RtePositionInTask=1, RteActivationOffset=0.0, RteMappedToTaskRef=OsTask_14, RteEventRef=DataReceivedEvent_0
      CPT_ACT_MOTOR_COMP: RteSoftwareComponentInstanceRef=CPT_ACT_MOTOR_COMP
        TE_ServerCall_100ms (RteEventToTaskMapping): RtePositionInTask=3, RteActivationOffset=0.0, RteMappedToTaskRef=OsTask_15, RteEventRef=TE_ServerCall_100ms
      CPT_APP_BRAKE_CONTROLL_COMP: RteSoftwareComponentInstanceRef=CPT_APP_BRAKE_CONTROLL_COMP
        4 x RteEventToTaskMapping, all with RtePositionInTask=1, RteActivationOffset=0.0:
          DataReceivedEvent_3: RteMappedToTaskRef=OsTask_16, RteEventRef=DataReceivedEvent_3
          DataReceivedEvent_1: RteMappedToTaskRef=OsTask_22, RteEventRef=DataReceivedEvent_1
          DataReceivedEvent_2: RteMappedToTaskRef=OsTask_24, RteEventRef=DataReceivedEvent_2
          DataReceivedEvent_0: RteMappedToTaskRef=OsTask_25, RteEventRef=DataReceivedEvent_0
      CPT_APP_MOTOR_COMP: RteSoftwareComponentInstanceRef=CPT_APP_MOTOR_COMP
        TE_100ms (RteEventToTaskMapping): RtePositionInTask=1, RteActivationOffset=0.0, RteMappedToTaskRef=OsTask_26, RteEventRef=TE_300ms
        TimingEvent_0 (RteEventToTaskMapping): RtePositionInTask=2, RteActivationOffset=0.0, RteMappedToTaskRef=OsTask_15, RteEventRef=TimingEvent_0
      CPT_AvgSpeed: RteSoftwareComponentInstanceRef=CPT_AvgSpeed
        TimingEvent_0 (RteEventToTaskMapping): RtePositionInTask=1, RteActivationOffset=0.0, RteMappedToTaskRef=OsTask_18, RteEventRef=TimingEvent_0
      CPT_Engine_Gear_ACT: RteSoftwareComponentInstanceRef=CPT_Engine_Gear_ACT
        3 x RteEventToTaskMapping, all with RteActivationOffset=0.0:
          ExternalTriggerOccurredEvent_2: RtePositionInTask=2, RteMappedToTaskRef=OsTask_19, RteEventRef=ExternalTriggerOccurredEvent_2
          ExternalTriggerOccurredEvent_0: RtePositionInTask=1, RteMappedToTaskRef=OsTask_7, RteEventRef=ExternalTriggerOccurredEvent_0
          ExternalTriggerOccurredEvent_1: RtePositionInTask=1, RteMappedToTaskRef=OsTask_20, RteEventRef=ExternalTriggerOccurredEvent_1
      CPT_EngineApp: RteSoftwareComponentInstanceRef=CPT_EngineApp
        TimingEvent_0 (RteEventToTaskMapping): RtePositionInTask=1, RteActivationOffset=0.0, RteMappedToTaskRef=OsTask_2, RteEventRef=TimingEvent_0
      CPT_ACT_HYDRAULIC_MODULATOR_REARL_COMP: RteSoftwareComponentInstanceRef=CPT_ACT_HYDRAULIC_MODULATOR_REARL_COMP
        DataReceivedEvent_0 (RteEventToTaskMapping): RtePositionInTask=1, RteActivationOffset=0.0, RteMappedToTaskRef=OsTask_3, RteEventRef=DataReceivedEvent_0
      CPT_Engine_Cycle_ACT: RteSoftwareComponentInstanceRef=CPT_Engine_Cycle_ACT
        TimingEvent_0 (RteEventToTaskMapping): RtePositionInTask=1, RteActivationOffset=0.0, RteMappedToTaskRef=OsTask_15, RteEventRef=TimingEvent_0
      CPT_ACT_HYDRAULIC_MODULATOR_FRONTL_COMP: RteSoftwareComponentInstanceRef=CPT_ACT_HYDRAULIC_MODULATOR_FRONTL_COMP
        DataReceivedEvent_0 (RteEventToTaskMapping): RtePositionInTask=1, RteActivationOffset=0.0, RteMappedToTaskRef=OsTask_6, RteEventRef=DataReceivedEvent_0
      CPT_Cylinder_Sen: RteSoftwareComponentInstanceRef=CPT_Cylinder_Sen
        TimingEvent_0 (RteEventToTaskMapping): RtePositionInTask=1, RteActivationOffset=0.0, RteMappedToTaskRef=OsTask_21, RteEventRef=TimingEvent_0
      CPT_ACT_HYDRAULIC_MODULATOR_FRONTR_COMP: RteSoftwareComponentInstanceRef=CPT_ACT_HYDRAULIC_MODULATOR_FRONTR_COMP
        DataReceivedEvent_0 (RteEventToTaskMapping): RtePositionInTask=1, RteActivationOffset=0.0, RteMappedToTaskRef=OsTask_23, RteEventRef=DataReceivedEvent_0
  module config OS_CFG: definition=Os
    5 x OsAppMode:
      OSDEFAULTAPPMODE
      OsAppMode_{0..3}
    26 x OsTask, all with OsTaskActivation=1:
      OsTask_0: OsTaskPriority=6
      OsTask_1: OsTaskPriority=4, OsTaskSchedule=FULL
      OsTask_2: OsTaskPriority=3, OsTaskSchedule=FULL
      OsTask_04: OsTaskPriority=4
      OsTask_5: OsTaskPriority=3, OsTaskSchedule=FULL
      OsTask_{10..12}: OsTaskPriority=4, OsTaskSchedule=FULL
      OsTask_{13..16}: OsTaskPriority=3, OsTaskSchedule=FULL
      OsTask_18: OsTaskPriority=3, OsTaskSchedule=FULL
      OsTask_19: OsTaskPriority=3, OsTaskSchedule=FULL
      OsTask_3: OsTaskPriority=3, OsTaskSchedule=FULL
      OsTask_4: OsTaskPriority=3, OsTaskSchedule=FULL
      OsTask_{6..8}: OsTaskPriority=3, OsTaskSchedule=FULL
      OsTask_{20..26}: OsTaskPriority=3, OsTaskSchedule=FULL
