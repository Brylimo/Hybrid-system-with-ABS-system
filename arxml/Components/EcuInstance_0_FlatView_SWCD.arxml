AUTOSAR XML (schema 4-0-3)
package /EcuInstance_0_FlatView/SwComponentTypes
  composition sw component type EcuInstance_0_FlatView
    19 x component:
      CPT_ACT_HYDRAULIC_MODULATOR_FRONTL_COMP: type=ACT_HYDRAULIC_MODULATOR_FRONTL_COMP
      CPT_ACT_HYDRAULIC_MODULATOR_FRONTR_COMP: type=ACT_HYDRAULIC_MODULATOR_FRONTR_COMP
      CPT_ACT_HYDRAULIC_MODULATOR_REARL_COMP: type=ACT_HYDRAULIC_MODULATOR_REARL_COMP
      CPT_ACT_HYDRAULIC_MODULATOR_REARR_COMP: type=ACT_HYDRAULIC_MODULATOR_REARR_COMP
      CPT_ACT_MOTOR_COMP: type=ACT_MOTOR_COMP
      CPT_APP_BRAKE_CONTROLL_COMP: type=APP_BRAKE_CONTROLL_COMP
      CPT_APP_MOTOR_COMP: type=APP_MOTOR_COMP
      CPT_AccelControlAPP: type=AccelControlAPP
      CPT_AccelPedalSen: type=AccelPedalSen
      CPT_AvgSpeed: type=AvgSpeed
      CPT_BrakePedalSen: type=BrakePedalSen
      CPT_Cylinder_Sen: type=Cylinder_Sen
      CPT_ECU_ABS: type=ECU_ABS
      CPT_EngineApp: type=EngineApp
      CPT_Engine_Cycle_ACT: type=Engine_Cycle_ACT
      CPT_Engine_Gear_ACT: type=Engine_Gear_ACT
      CPT_GearModeSen: type=GearModeSen
      CPT_SEN_BATT_COMP: type=SEN_BATT_COMP
      CPT_SpeedSen: type=SpeedSen
    connect CPT_APP_BRAKE_CONTROLL_COMP.APP_FL_Mode_Send -> CPT_ACT_HYDRAULIC_MODULATOR_FRONTL_COMP.ACT_HM_FL_Recv
    connect CPT_APP_BRAKE_CONTROLL_COMP.APP_FR_Mode_Send -> CPT_ACT_HYDRAULIC_MODULATOR_FRONTR_COMP.ACT_HM_FR_Recv
    connect CPT_APP_BRAKE_CONTROLL_COMP.APP_RL_Mode_Send -> CPT_ACT_HYDRAULIC_MODULATOR_REARL_COMP.ACT_HM_RL_Recv
    connect CPT_APP_BRAKE_CONTROLL_COMP.APP_RR_Mode_Send -> CPT_ACT_HYDRAULIC_MODULATOR_REARR_COMP.ACT_HM_RR_Recv
    connect CPT_APP_MOTOR_COMP.SR_MOTOR_SPEED_Send -> CPT_ACT_MOTOR_COMP.SR_MOTOR_SPEED_Recv
    connect CPT_APP_MOTOR_COMP.TR_BATT_LOW_set -> CPT_AccelControlAPP.R_BatteryStat
    connect CPT_AccelControlAPP.P_EnginePower -> CPT_EngineApp.Power_Rport
    connect CPT_AccelControlAPP.P_PWM -> CPT_APP_MOTOR_COMP.SR_PWM_Recv
    connect CPT_AccelPedalSen.toApp_PPort -> CPT_AccelControlAPP.R_Accel
    connect CPT_AvgSpeed.P_avg_speed -> CPT_AccelControlAPP.R_AvgSpeed
    connect CPT_BrakePedalSen.toApp_PPort -> CPT_AccelControlAPP.R_Brake
    connect CPT_Cylinder_Sen.Pport -> CPT_EngineApp.Cylinder_Rport
    connect CPT_ECU_ABS.ActSEngine -> CPT_Engine_Cycle_ACT.Engine_Cleintport
    connect CPT_ECU_ABS.ActSGear -> CPT_Engine_Gear_ACT.phyGear_relayPport
    connect CPT_ECU_ABS.CS_BATT_Server -> CPT_SEN_BATT_COMP.CS_BATT_Receive
    connect CPT_ECU_ABS.CS_MOTOR_Server -> CPT_ACT_MOTOR_COMP.CS_MOTOR_Client
    connect CPT_ECU_ABS.PAccelPedal -> CPT_AccelPedalSen.RPort
    connect CPT_ECU_ABS.PBrakePedal -> CPT_BrakePedalSen.RPort
    connect CPT_ECU_ABS.PCylinder -> CPT_Cylinder_Sen.Rport
    connect CPT_ECU_ABS.PGearMode -> CPT_GearModeSen.RPort
    connect CPT_ECU_ABS.PHMFrontL -> CPT_ACT_HYDRAULIC_MODULATOR_FRONTL_COMP.ACT_HM_FL_Client
    connect CPT_ECU_ABS.PHMFrontR -> CPT_ACT_HYDRAULIC_MODULATOR_FRONTR_COMP.ACT_HM_FR_Client
    connect CPT_ECU_ABS.PHMRearL -> CPT_ACT_HYDRAULIC_MODULATOR_REARL_COMP.ACT_HM_RL_Client
    connect CPT_ECU_ABS.PHMRearR -> CPT_ACT_HYDRAULIC_MODULATOR_REARR_COMP.ACT_HM_RR_Client
    connect CPT_ECU_ABS.PTireRPM -> CPT_SpeedSen.RPort
    connect CPT_EngineApp.CycleData_Pport -> CPT_Engine_Cycle_ACT.CycleData_Rport
    connect CPT_EngineApp.PhyGear_Pport -> CPT_Engine_Gear_ACT.phyGear_Rport
    connect CPT_GearModeSen.toApp_PPort -> CPT_AccelControlAPP.R_Gear
    connect CPT_SEN_BATT_COMP.SR_BATT_Send -> CPT_APP_MOTOR_COMP.SR_BATT_Recv
    connect CPT_SpeedSen.toApp_PPort -> CPT_APP_BRAKE_CONTROLL_COMP.APP_Speed_Receive
    connect CPT_SpeedSen.toApp_PPort -> CPT_AvgSpeed.R_4speeds
