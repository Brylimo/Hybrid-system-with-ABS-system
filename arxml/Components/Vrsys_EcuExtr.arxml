AUTOSAR XML (schema 4-0-3)
package /Vrsys_EcuExtract
  system EXTR_EcuInstance_0: category=ECU_EXTRACT, ecu-extract-version=1.0.0, system-version=1.0.0
    system mapping SYSMPG_EcuInstance_0
      sw-mappings:
        swc to ecu mapping SwcToEcuMapping_0: ecu-instance=EcuInstance_0
          component:
            CPT_EcuInstance_0_FlatView.CPT_ACT_HYDRAULIC_MODULATOR_FRONTL_COMP
            CPT_EcuInstance_0_FlatView.CPT_ACT_HYDRAULIC_MODULATOR_FRONTR_COMP
            CPT_EcuInstance_0_FlatView.CPT_ACT_HYDRAULIC_MODULATOR_REARL_COMP
            CPT_EcuInstance_0_FlatView.CPT_ACT_HYDRAULIC_MODULATOR_REARR_COMP
            CPT_EcuInstance_0_FlatView.CPT_ACT_MOTOR_COMP
            CPT_EcuInstance_0_FlatView.CPT_APP_BRAKE_CONTROLL_COMP
            CPT_EcuInstance_0_FlatView.CPT_APP_MOTOR_COMP
            CPT_EcuInstance_0_FlatView.CPT_AccelControlAPP
            CPT_EcuInstance_0_FlatView.CPT_AccelPedalSen
            CPT_EcuInstance_0_FlatView.CPT_AvgSpeed
            CPT_EcuInstance_0_FlatView.CPT_BrakePedalSen
            CPT_EcuInstance_0_FlatView.CPT_Cylinder_Sen
            CPT_EcuInstance_0_FlatView.CPT_ECU_ABS
            CPT_EcuInstance_0_FlatView.CPT_EngineApp
            CPT_EcuInstance_0_FlatView.CPT_Engine_Cycle_ACT
            CPT_EcuInstance_0_FlatView.CPT_Engine_Gear_ACT
            CPT_EcuInstance_0_FlatView.CPT_GearModeSen
            CPT_EcuInstance_0_FlatView.CPT_SEN_BATT_COMP
            CPT_EcuInstance_0_FlatView.CPT_SpeedSen
    root-software-compositions:
      root sw composition prototype CPT_EcuInstance_0_FlatView: flat-map=EcuInstance_0_FlatMap, software-composition=EcuInstance_0_FlatView
