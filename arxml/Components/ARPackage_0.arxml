AUTOSAR XML (schema 4-0-3)
package /ARPackage_0
  composition sw component type TopLevelComposition
    6 x component:
      CPT_SpeedSen: type=SpeedSen
      CPT_ECU_ABS: type=ECU_ABS
      CPT_Engine_Composition: type=Engine_Composition
      CPT_BRAKE_COMPOSITION: type=BRAKE_COMPOSITION
      CPT_MotorComposition: type=MotorComposition
      CPT_AComposition: type=AComposition
    connect CPT_ECU_ABS.PTireRPM -> CPT_SpeedSen.RPort
    connect CPT_ECU_ABS.ActSEngine -> CPT_Engine_Composition.Engine_Cleintport
    connect CPT_ECU_ABS.ActSGear -> CPT_Engine_Composition.phyGear_relayPport_0
    connect CPT_SpeedSen.toApp_PPort -> CPT_BRAKE_COMPOSITION.APP_Speed_Receive_0
    connect CPT_ECU_ABS.PHMFrontL -> CPT_BRAKE_COMPOSITION.ACT_HM_FL_Client_0
    connect CPT_ECU_ABS.PHMFrontR -> CPT_BRAKE_COMPOSITION.ACT_HM_FR_Client_0
    connect CPT_ECU_ABS.PHMRearL -> CPT_BRAKE_COMPOSITION.ACT_HM_RL_Client_0
    connect CPT_ECU_ABS.PHMRearR -> CPT_BRAKE_COMPOSITION.ACT_HM_RR_Client_0
    connect CPT_ECU_ABS.CS_MOTOR_Server -> CPT_MotorComposition.CS_MOTOR_Client
    connect CPT_ECU_ABS.CS_BATT_Server -> CPT_MotorComposition.CS_BATT_Receive
    connect CPT_SpeedSen.toApp_PPort -> CPT_AComposition.R_4speeds
    connect CPT_ECU_ABS.PAccelPedal -> CPT_AComposition.RPort
    connect CPT_AComposition.P_EnginePower -> CPT_Engine_Composition.Power_Rport
    connect CPT_ECU_ABS.PGearMode -> CPT_AComposition.RPort_1
    connect CPT_AComposition.P_PWM -> CPT_MotorComposition.SR_PWM_Recv_0
    connect CPT_ECU_ABS.PBrakePedal -> CPT_AComposition.RPort_0
    connect CPT_ECU_ABS.PCylinder -> CPT_Engine_Composition.Rport
    connect CPT_MotorComposition.TR_BATT_LOW_set_1 -> CPT_AComposition.R_BatteryStat
package /ARPackage_0/PortInterfaceMappingSets
  port interface mapping set PIMSet_TopLevelComposition
