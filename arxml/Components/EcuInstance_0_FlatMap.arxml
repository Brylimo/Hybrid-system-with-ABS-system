AUTOSAR XML (schema 4-0-3)
package /EcuInstance_0_FlatView
  flat map EcuInstance_0_FlatMap
    38 x flat instance descriptor:
      CPT_ACT_HYDRAULIC_MODULATOR_FRONTL_COMP: upstream-reference=RootSwCompositionPrototype_0.CPT_BRAKE_COMPOSITION.CPT_ACT_HYDRAULIC_MODULATOR_FRONTL_COMP, ecu-extract-reference=CPT_EcuInstance_0_FlatView.CPT_ACT_HYDRAULIC_MODULATOR_FRONTL_COMP
      CPT_ACT_HYDRAULIC_MODULATOR_FRONTR_COMP: upstream-reference=RootSwCompositionPrototype_0.CPT_BRAKE_COMPOSITION.CPT_ACT_HYDRAULIC_MODULATOR_FRONTR_COMP, ecu-extract-reference=CPT_EcuInstance_0_FlatView.CPT_ACT_HYDRAULIC_MODULATOR_FRONTR_COMP
      CPT_ACT_HYDRAULIC_MODULATOR_REARL_COMP: upstream-reference=RootSwCompositionPrototype_0.CPT_BRAKE_COMPOSITION.CPT_ACT_HYDRAULIC_MODULATOR_REARL_COMP, ecu-extract-reference=CPT_EcuInstance_0_FlatView.CPT_ACT_HYDRAULIC_MODULATOR_REARL_COMP
      CPT_ACT_HYDRAULIC_MODULATOR_REARR_COMP: upstream-reference=RootSwCompositionPrototype_0.CPT_BRAKE_COMPOSITION.CPT_ACT_HYDRAULIC_MODULATOR_REARR_COMP, ecu-extract-reference=CPT_EcuInstance_0_FlatView.CPT_ACT_HYDRAULIC_MODULATOR_REARR_COMP
      CPT_ACT_MOTOR_COMP: upstream-reference=RootSwCompositionPrototype_0.CPT_MotorComposition.CPT_ACT_MOTOR_COMP, ecu-extract-reference=CPT_EcuInstance_0_FlatView.CPT_ACT_MOTOR_COMP
      CPT_APP_BRAKE_CONTROLL_COMP: upstream-reference=RootSwCompositionPrototype_0.CPT_BRAKE_COMPOSITION.CPT_APP_BRAKE_CONTROLL_COMP, ecu-extract-reference=CPT_EcuInstance_0_FlatView.CPT_APP_BRAKE_CONTROLL_COMP
      CPT_APP_MOTOR_COMP: upstream-reference=RootSwCompositionPrototype_0.CPT_MotorComposition.CPT_APP_MOTOR_COMP, ecu-extract-reference=CPT_EcuInstance_0_FlatView.CPT_APP_MOTOR_COMP
      CPT_AccelControlAPP: upstream-reference=RootSwCompositionPrototype_0.CPT_AComposition.CPT_AccelControlAPP, ecu-extract-reference=CPT_EcuInstance_0_FlatView.CPT_AccelControlAPP
      CPT_AccelPedalSen: upstream-reference=RootSwCompositionPrototype_0.CPT_AComposition.CPT_AccelPedalSen, ecu-extract-reference=CPT_EcuInstance_0_FlatView.CPT_AccelPedalSen
      CPT_AvgSpeed: upstream-reference=RootSwCompositionPrototype_0.CPT_AComposition.CPT_AvgSpeed, ecu-extract-reference=CPT_EcuInstance_0_FlatView.CPT_AvgSpeed
      CPT_BrakePedalSen: upstream-reference=RootSwCompositionPrototype_0.CPT_AComposition.CPT_BrakePedalSen, ecu-extract-reference=CPT_EcuInstance_0_FlatView.CPT_BrakePedalSen
      CPT_Cylinder_Sen: upstream-reference=RootSwCompositionPrototype_0.CPT_Engine_Composition.CPT_Cylinder_Sen, ecu-extract-reference=CPT_EcuInstance_0_FlatView.CPT_Cylinder_Sen
      CPT_ECU_ABS: upstream-reference=RootSwCompositionPrototype_0.CPT_ECU_ABS, ecu-extract-reference=CPT_EcuInstance_0_FlatView.CPT_ECU_ABS
      CPT_EngineApp: upstream-reference=RootSwCompositionPrototype_0.CPT_Engine_Composition.CPT_EngineApp, ecu-extract-reference=CPT_EcuInstance_0_FlatView.CPT_EngineApp
      CPT_Engine_Cycle_ACT: upstream-reference=RootSwCompositionPrototype_0.CPT_Engine_Composition.CPT_Engine_Cycle_ACT, ecu-extract-reference=CPT_EcuInstance_0_FlatView.CPT_Engine_Cycle_ACT
      CPT_Engine_Gear_ACT: upstream-reference=RootSwCompositionPrototype_0.CPT_Engine_Composition.CPT_Engine_Gear_ACT, ecu-extract-reference=CPT_EcuInstance_0_FlatView.CPT_Engine_Gear_ACT
      CPT_GearModeSen: upstream-reference=RootSwCompositionPrototype_0.CPT_AComposition.CPT_GearModeSen, ecu-extract-reference=CPT_EcuInstance_0_FlatView.CPT_GearModeSen
      CPT_SEN_BATT_COMP: upstream-reference=RootSwCompositionPrototype_0.CPT_MotorComposition.CPT_SEN_BATT_COMP, ecu-extract-reference=CPT_EcuInstance_0_FlatView.CPT_SEN_BATT_COMP
      CPT_SpeedSen: upstream-reference=RootSwCompositionPrototype_0.CPT_SpeedSen, ecu-extract-reference=CPT_EcuInstance_0_FlatView.CPT_SpeedSen
      accel_value: sw-refresh-timing={cse-code=5, cse-code-factor=1}, upstream-reference=RootSwCompositionPrototype_0.CPT_AComposition.CPT_AccelPedalSen.toApp_PPort.accel_value, ecu-extract-reference=CPT_EcuInstance_0_FlatView.CPT_AccelPedalSen.toApp_PPort.accel_value
      avg_speed_data: sw-refresh-timing={cse-code=5, cse-code-factor=3}, upstream-reference=RootSwCompositionPrototype_0.CPT_AComposition.CPT_AvgSpeed.P_avg_speed.avg_speed_data, ecu-extract-reference=CPT_EcuInstance_0_FlatView.CPT_AvgSpeed.P_avg_speed.avg_speed_data
      backleft: sw-refresh-timing={cse-code=4, cse-code-factor=9}, upstream-reference=RootSwCompositionPrototype_0.CPT_SpeedSen.toApp_PPort.backleft, ecu-extract-reference=CPT_EcuInstance_0_FlatView.CPT_SpeedSen.toApp_PPort.backleft
      backright: sw-refresh-timing={cse-code=4, cse-code-factor=9}, upstream-reference=RootSwCompositionPrototype_0.CPT_SpeedSen.toApp_PPort.backright, ecu-extract-reference=CPT_EcuInstance_0_FlatView.CPT_SpeedSen.toApp_PPort.backright
      batt_data: sw-refresh-timing={cse-code=5, cse-code-factor=3}, upstream-reference=RootSwCompositionPrototype_0.CPT_MotorComposition.CPT_SEN_BATT_COMP.SR_BATT_Send.batt_data, ecu-extract-reference=CPT_EcuInstance_0_FlatView.CPT_SEN_BATT_COMP.SR_BATT_Send.batt_data
      brake_value: sw-refresh-timing={cse-code=5, cse-code-factor=1}, upstream-reference=RootSwCompositionPrototype_0.CPT_AComposition.CPT_BrakePedalSen.toApp_PPort.brake_value, ecu-extract-reference=CPT_EcuInstance_0_FlatView.CPT_BrakePedalSen.toApp_PPort.brake_value
      frontleft: sw-refresh-timing={cse-code=4, cse-code-factor=9}, upstream-reference=RootSwCompositionPrototype_0.CPT_SpeedSen.toApp_PPort.frontleft, ecu-extract-reference=CPT_EcuInstance_0_FlatView.CPT_SpeedSen.toApp_PPort.frontleft
      frontright: sw-refresh-timing={cse-code=4, cse-code-factor=9}, upstream-reference=RootSwCompositionPrototype_0.CPT_SpeedSen.toApp_PPort.frontright, ecu-extract-reference=CPT_EcuInstance_0_FlatView.CPT_SpeedSen.toApp_PPort.frontright
      gear_value: sw-refresh-timing={cse-code=5, cse-code-factor=1}, upstream-reference=RootSwCompositionPrototype_0.CPT_AComposition.CPT_GearModeSen.toApp_PPort.gear_value, ecu-extract-reference=CPT_EcuInstance_0_FlatView.CPT_GearModeSen.toApp_PPort.gear_value
      infoArray: sw-refresh-timing={cse-code=5, cse-code-factor=4}, upstream-reference=RootSwCompositionPrototype_0.CPT_Engine_Composition.CPT_EngineApp.CycleData_Pport.infoArray, ecu-extract-reference=CPT_EcuInstance_0_FlatView.CPT_EngineApp.CycleData_Pport.infoArray
      modedata: sw-refresh-timing={cse-code=1000, cse-code-factor=1}, upstream-reference=RootSwCompositionPrototype_0.CPT_BRAKE_COMPOSITION.CPT_APP_BRAKE_CONTROLL_COMP.APP_FL_Mode_Send.modedata, ecu-extract-reference=CPT_EcuInstance_0_FlatView.CPT_APP_BRAKE_CONTROLL_COMP.APP_FL_Mode_Send.modedata
      modedata_0: sw-refresh-timing={cse-code=1000, cse-code-factor=1}, upstream-reference=RootSwCompositionPrototype_0.CPT_BRAKE_COMPOSITION.CPT_APP_BRAKE_CONTROLL_COMP.APP_FR_Mode_Send.modedata, ecu-extract-reference=CPT_EcuInstance_0_FlatView.CPT_APP_BRAKE_CONTROLL_COMP.APP_FR_Mode_Send.modedata
      modedata_1: sw-refresh-timing={cse-code=1000, cse-code-factor=1}, upstream-reference=RootSwCompositionPrototype_0.CPT_BRAKE_COMPOSITION.CPT_APP_BRAKE_CONTROLL_COMP.APP_RL_Mode_Send.modedata, ecu-extract-reference=CPT_EcuInstance_0_FlatView.CPT_APP_BRAKE_CONTROLL_COMP.APP_RL_Mode_Send.modedata
      modedata_2: sw-refresh-timing={cse-code=1000, cse-code-factor=1}, upstream-reference=RootSwCompositionPrototype_0.CPT_BRAKE_COMPOSITION.CPT_APP_BRAKE_CONTROLL_COMP.APP_RR_Mode_Send.modedata, ecu-extract-reference=CPT_EcuInstance_0_FlatView.CPT_APP_BRAKE_CONTROLL_COMP.APP_RR_Mode_Send.modedata
      motor_speed_data: sw-refresh-timing={cse-code=5, cse-code-factor=3}, upstream-reference=RootSwCompositionPrototype_0.CPT_MotorComposition.CPT_APP_MOTOR_COMP.SR_MOTOR_SPEED_Send.motor_speed_data, ecu-extract-reference=CPT_EcuInstance_0_FlatView.CPT_APP_MOTOR_COMP.SR_MOTOR_SPEED_Send.motor_speed_data
      powerValue: sw-refresh-timing={cse-code=5, cse-code-factor=3}, upstream-reference=RootSwCompositionPrototype_0.CPT_AComposition.CPT_AccelControlAPP.P_EnginePower.powerValue, ecu-extract-reference=CPT_EcuInstance_0_FlatView.CPT_AccelControlAPP.P_EnginePower.powerValue
      pwm_data: sw-refresh-timing={cse-code=5, cse-code-factor=3}, upstream-reference=RootSwCompositionPrototype_0.CPT_AComposition.CPT_AccelControlAPP.P_PWM.pwm_data, ecu-extract-reference=CPT_EcuInstance_0_FlatView.CPT_AccelControlAPP.P_PWM.pwm_data
      pressure: sw-refresh-timing={cse-code=5, cse-code-factor=3}, upstream-reference=RootSwCompositionPrototype_0.CPT_Engine_Composition.CPT_Cylinder_Sen.Pport.pressure, ecu-extract-reference=CPT_EcuInstance_0_FlatView.CPT_Cylinder_Sen.Pport.pressure
      temperature: sw-refresh-timing={cse-code=5, cse-code-factor=3}, upstream-reference=RootSwCompositionPrototype_0.CPT_Engine_Composition.CPT_Cylinder_Sen.Pport.temperature, ecu-extract-reference=CPT_EcuInstance_0_FlatView.CPT_Cylinder_Sen.Pport.temperature
